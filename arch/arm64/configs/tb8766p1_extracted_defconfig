## arch/arm64/configs/tb8766p1_extracted_defconfig
```kconfig
CONFIG_ARM64=y
CONFIG_64BIT=y
CONFIG_ARCH_PHYS_ADDR_T_64BIT=y
CONFIG_MMU=y
CONFIG_PREEMPT=y
CONFIG_HZ_250=y
CONFIG_MACH_MT6761=y
CONFIG_CMDLINE="console=tty0 console=ttyMT3,921600n1 root=/dev/ram vmalloc=496M slub_max_order=0 slub_debug=O "
CONFIG_CMDLINE_FROM_BOOTLOADER=y
CONFIG_BUILD_ARM64_APPENDED_DTB_IMAGE=y
CONFIG_BUILD_ARM64_DTB_OVERLAY_IMAGE=y
CONFIG_IMG_GZ_DTB=y
CONFIG_BUILD_ARM64_APPENDED_KERNEL_IMAGE_NAME="Image.gz-dtb"
CONFIG_BUILD_ARM64_APPENDED_DTB_IMAGE_NAMES="mediatek/mt6761"
CONFIG_BUILD_ARM64_DTB_OVERLAY_IMAGE_NAMES="mediatek/tb8766p1_64_bsp"
CONFIG_INPUT=y
CONFIG_INPUT_EVDEV=y
CONFIG_INPUT_TOUCHSCREEN=y
CONFIG_TOUCHSCREEN_MTK=y
CONFIG_INPUT_KEYBOARD=y
CONFIG_KEYBOARD_MTK=y
CONFIG_SOUND=y
CONFIG_SND=y
CONFIG_SND_SOC=y
CONFIG_MTK_SND_SOC_NEW_ARCH=y
CONFIG_MTK_SND_SOC_CODEC="mt6357"
CONFIG_SND_SOC_MTK_BTCVSD=y
CONFIG_MTK_CAMERA_ISP=y
CONFIG_MTK_IMGSENSOR=y
CONFIG_CUSTOM_KERNEL_IMGSENSOR="ov2680_mipi_raw ov8858_mipi_raw gc2365_mipi_raw imx214_mipi_raw gc8034_mipi_raw ar0842_mipi_raw ar0543_mipi_raw gc2385_mipi_raw gc5025_mipi_raw"
CONFIG_MEDIATEK_SOLUTION=y
CONFIG_MTK_PLATFORM="mt6761"
CONFIG_ARCH_MTK_PROJECT="tb8766p1_64_bsp"
CONFIG_MTK_DTBO_FEATURE=y
```
