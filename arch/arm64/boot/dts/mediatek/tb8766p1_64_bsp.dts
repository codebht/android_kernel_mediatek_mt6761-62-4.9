/dts-v1/;

/ {
	model = "MT6761";
	compatible = "mediatek,MT6761";
	interrupt-parent = <0x01>;
	#address-cells = <0x02>;
	#size-cells = <0x02>;

	chosen {
		bootargs = "console=tty0 console=ttyS0,921600n1 vmalloc=400M slub_debug=OFZPU page_owner=on swiotlb=noforce androidboot.hardware=mt6761 maxcpus=8 loop.max_part=7 firmware_class.path=/vendor/firmware";
		kaslr-seed = <0x00 0x00>;
		linux,phandle = <0x66>;
		phandle = <0x66>;
	};

	cpus {
		#address-cells = <0x01>;
		#size-cells = <0x00>;

		cpu@000 {
			device_type = "cpu";
			compatible = "arm,cortex-a53";
			reg = <0x00>;
			enable-method = "psci";
			clock-frequency = <0x8b799100>;
			cpu-idle-states = <0x02 0x03 0x04 0x05 0x06 0x07 0x08>;
			linux,phandle = <0x09>;
			phandle = <0x09>;
		};

		cpu@001 {
			device_type = "cpu";
			compatible = "arm,cortex-a53";
			reg = <0x01>;
			enable-method = "psci";
			clock-frequency = <0x8b799100>;
			cpu-idle-states = <0x02 0x03 0x04 0x05 0x06 0x07 0x08>;
			linux,phandle = <0x0a>;
			phandle = <0x0a>;
		};

		cpu@002 {
			device_type = "cpu";
			compatible = "arm,cortex-a53";
			reg = <0x02>;
			enable-method = "psci";
			clock-frequency = <0x8b799100>;
			cpu-idle-states = <0x02 0x03 0x04 0x05 0x06 0x07 0x08>;
			linux,phandle = <0x0b>;
			phandle = <0x0b>;
		};

		cpu@003 {
			device_type = "cpu";
			compatible = "arm,cortex-a53";
			reg = <0x03>;
			enable-method = "psci";
			clock-frequency = <0x8b799100>;
			cpu-idle-states = <0x02 0x03 0x04 0x05 0x06 0x07 0x08>;
			linux,phandle = <0x0c>;
			phandle = <0x0c>;
		};

		cpu-map {

			cluster0 {

				core0 {
					cpu = <0x09>;
				};

				core1 {
					cpu = <0x0a>;
				};

				core2 {
					cpu = <0x0b>;
				};

				core3 {
					cpu = <0x0c>;
				};
			};
		};

		idle-states {
			entry-method = "arm,psci";

			standby {
				compatible = "arm,idle-state";
				arm,psci-suspend-param = <0x01>;
				entry-latency-us = <0x258>;
				exit-latency-us = <0x258>;
				min-residency-us = <0x4b0>;
				linux,phandle = <0x02>;
				phandle = <0x02>;
			};

			mcdi-cpu {
				compatible = "arm,idle-state";
				arm,psci-suspend-param = <0x10001>;
				entry-latency-us = <0x258>;
				exit-latency-us = <0x258>;
				min-residency-us = <0x4b0>;
				linux,phandle = <0x03>;
				phandle = <0x03>;
			};

			mcdi-cluster {
				compatible = "arm,idle-state";
				arm,psci-suspend-param = <0x1010001>;
				entry-latency-us = <0x258>;
				exit-latency-us = <0x258>;
				min-residency-us = <0x4b0>;
				linux,phandle = <0x04>;
				phandle = <0x04>;
			};

			sodi {
				compatible = "arm,idle-state";
				arm,psci-suspend-param = <0x1010002>;
				entry-latency-us = <0x320>;
				exit-latency-us = <0x3e8>;
				min-residency-us = <0x7d0>;
				linux,phandle = <0x05>;
				phandle = <0x05>;
			};

			sodi3 {
				compatible = "arm,idle-state";
				arm,psci-suspend-param = <0x1010003>;
				entry-latency-us = <0x320>;
				exit-latency-us = <0x3e8>;
				min-residency-us = <0x7d0>;
				linux,phandle = <0x06>;
				phandle = <0x06>;
			};

			dpidle {
				compatible = "arm,idle-state";
				arm,psci-suspend-param = <0x1010004>;
				entry-latency-us = <0x320>;
				exit-latency-us = <0x3e8>;
				min-residency-us = <0x7d0>;
				linux,phandle = <0x07>;
				phandle = <0x07>;
			};

			suspend {
				compatible = "arm,idle-state";
				arm,psci-suspend-param = <0x1010005>;
				entry-latency-us = <0x320>;
				exit-latency-us = <0x3e8>;
				min-residency-us = <0x7d0>;
				linux,phandle = <0x08>;
				phandle = <0x08>;
			};
		};
	};

	psci {
		compatible = "arm,psci-1.0";
		method = "smc";
	};

	pmu {
		compatible = "arm,armv8-pmuv3";
		interrupt-parent = <0x0d>;
		interrupts = <0x01 0x07 0x08>;
	};

	l2c_parity {
		compatible = "mediatek,l2c_parity-v1";
		interrupts = <0x00 0x00 0x04>;
	};

	memory {
		device_type = "memory";
		reg = <0x00 0x40000000 0x00 0x20000000>;
	};

	reserved-memory {
		#address-cells = <0x02>;
		#size-cells = <0x02>;
		ranges;
		linux,phandle = <0x67>;
		phandle = <0x67>;

		zmc-default {
			compatible = "mediatek,zone_movable_cma";
			size = <0x00 0xffc00000>;
			alignment = <0x00 0x10000000>;
			alloc-ranges = <0x00 0xc0000000 0x01 0x80000000>;
		};

		reserve-memory-sspm_share {
			compatible = "mediatek,reserve-memory-sspm_share";
			no-map;
			status = "okay";
			size = <0x00 0x510000>;
			alignment = <0x00 0x10000>;
			alloc-ranges = <0x00 0x40000000 0x00 0x60000000>;
		};

		reserve-memory-scp_share {
			compatible = "mediatek,reserve-memory-scp_share";
			no-map;
			size = <0x00 0x300000>;
			alignment = <0x00 0x1000000>;
			alloc-ranges = <0x00 0x40000000 0x00 0x50000000>;
		};

		consys-reserve-memory {
			compatible = "mediatek,consys-reserve-memory";
			no-map;
			size = <0x00 0x400000>;
			alignment = <0x00 0x1000000>;
			alloc-ranges = <0x00 0x40000000 0x00 0x80000000>;
		};

		wifi-reserve-memory {
			compatible = "mediatek,wifi-reserve-memory";
			no-map;
			size = <0x00 0x300000>;
			alignment = <0x00 0x1000000>;
			alloc-ranges = <0x00 0x40000000 0x00 0x80000000>;
		};

		soter-shared-mem {
			compatible = "microtrust,shared_mem";
			no-map;
			size = <0x00 0x200000>;
			alloc-ranges = <0x00 0x40000000 0x00 0x50000000>;
		};
	};

	utos {
		compatible = "microtrust,utos";
		interrupts = <0x00 0xbc 0x01 0x00 0xbd 0x01>;
	};

	utos_tester {
		compatible = "microtrust,tester-v1";
	};

	cpu_dbgapb@0d410000 {
		compatible = "mediatek,hw_dbg";
		num = <0x08>;
		reg = <0x00 0xd410000 0x00 0x1000 0x00 0xd510000 0x00 0x1000 0x00 0xd610000 0x00 0x1000 0x00 0xd710000 0x00 0x1000 0x00 0xd810000 0x00 0x1000 0x00 0xd910000 0x00 0x1000 0x00 0xda10000 0x00 0x1000 0x00 0xdb10000 0x00 0x1000>;
		linux,phandle = <0x68>;
		phandle = <0x68>;
	};

	atf_logger {
		compatible = "mediatek,atf_logger";
		interrupts = <0x00 0x4e 0x01>;
	};

	amms_control {
		compatible = "mediatek,amms";
		interrupts = <0x00 0x43 0x01>;
	};

	interrupt-controller@0c000000 {
		compatible = "arm,gic-v3";
		#interrupt-cells = <0x03>;
		#address-cells = <0x02>;
		#size-cells = <0x02>;
		#redistributor-regions = <0x01>;
		interrupt-parent = <0x0d>;
		interrupt-controller;
		reg = <0x00 0xc000000 0x00 0x40000 0x00 0xc080000 0x00 0x200000 0x00 0x10200a80 0x00 0x50>;
		interrupts = <0x01 0x09 0x04>;
		linux,phandle = <0x0d>;
		phandle = <0x0d>;
	};

	intpol-controller@10200a80 {
		compatible = "mediatek,mt6577-sysirq";
		interrupt-controller;
		#interrupt-cells = <0x03>;
		interrupt-parent = <0x0d>;
		reg = <0x00 0x10200a80 0x00 0x50>;
		linux,phandle = <0x01>;
		phandle = <0x01>;
	};

	infracfg_ao@10001000 {
		compatible = "mediatek,infracfg_ao\0syscon";
		reg = <0x00 0x10001000 0x00 0x1000>;
		interrupts = <0x00 0x5b 0x01>;
		#clock-cells = <0x01>;
		linux,phandle = <0x1f>;
		phandle = <0x1f>;
	};

	mcdi@0010fc00 {
		compatible = "mediatek,mt6761-mcdi";
		reg = <0x00 0x10fc00 0x00 0x800>;
	};

	scpsys@10001000 {
		compatible = "mediatek,scpsys\0syscon";
		reg = <0x00 0x10001000 0x00 0x1000 0x00 0x10006000 0x00 0x1000 0x00 0x14002000 0x00 0x1000 0x00 0x1020e000 0x00 0x1000 0x00 0x18004000 0x00 0x1000>;
		#clock-cells = <0x01>;
		linux,phandle = <0x20>;
		phandle = <0x20>;
	};

	topckgen@10000000 {
		compatible = "mediatek,topckgen\0syscon";
		reg = <0x00 0x10000000 0x00 0x1000>;
		#clock-cells = <0x01>;
		linux,phandle = <0x19>;
		phandle = <0x19>;
	};

	io_cfg_lt@10002000 {
		compatible = "mediatek,io_cfg_lt";
		reg = <0x00 0x10002000 0x00 0x200>;
	};

	syscfg_pctl_1@10002000 {
		compatible = "mediatek,mt6761-pctl-1-syscfg\0syscon";
		reg = <0x00 0x10002000 0x00 0x1000>;
		linux,phandle = <0x12>;
		phandle = <0x12>;
	};

	io_cfg_lm@10002200 {
		compatible = "mediatek,io_cfg_lm";
		reg = <0x00 0x10002200 0x00 0x200>;
	};

	syscfg_pctl_2@10002200 {
		compatible = "mediatek,mt6761-pctl-2-syscfg\0syscon";
		reg = <0x00 0x10002200 0x00 0x1000>;
		linux,phandle = <0x13>;
		phandle = <0x13>;
	};

	io_cfg_lb@10002400 {
		compatible = "mediatek,io_cfg_lb";
		reg = <0x00 0x10002400 0x00 0x200>;
	};

	syscfg_pctl_3@10002400 {
		compatible = "mediatek,mt6761-pctl-3-syscfg\0syscon";
		reg = <0x00 0x10002400 0x00 0x1000>;
		linux,phandle = <0x14>;
		phandle = <0x14>;
	};

	io_cfg_bl@10002600 {
		compatible = "mediatek,io_cfg_bl";
		reg = <0x00 0x10002600 0x00 0x200>;
	};

	syscfg_pctl_4@10002600 {
		compatible = "mediatek,mt6761-pctl-4-syscfg\0syscon";
		reg = <0x00 0x10002600 0x00 0x1000>;
		linux,phandle = <0x15>;
		phandle = <0x15>;
	};

	io_cfg_rr@10002800 {
		compatible = "mediatek,io_cfg_rr";
		reg = <0x00 0x10002800 0x00 0x200>;
	};

	syscfg_pctl_5@10002800 {
		compatible = "mediatek,mt6761-pctl-5-syscfg\0syscon";
		reg = <0x00 0x10002800 0x00 0x1000>;
		linux,phandle = <0x16>;
		phandle = <0x16>;
	};

	io_cfg_rb@10002a00 {
		compatible = "mediatek,io_cfg_rb";
		reg = <0x00 0x10002a00 0x00 0x200>;
	};

	syscfg_pctl_6@10002a00 {
		compatible = "mediatek,mt6761-pctl-6-syscfg\0syscon";
		reg = <0x00 0x10002a00 0x00 0x1000>;
		linux,phandle = <0x17>;
		phandle = <0x17>;
	};

	io_cfg_rt@10002c00 {
		compatible = "mediatek,io_cfg_rt";
		reg = <0x00 0x10002c00 0x00 0x200>;
	};

	syscfg_pctl_7@10002c00 {
		compatible = "mediatek,mt6761-pctl-7-syscfg\0syscon";
		reg = <0x00 0x10002c00 0x00 0x1000>;
		linux,phandle = <0x18>;
		phandle = <0x18>;
	};

	pericfg@10003000 {
		compatible = "mediatek,pericfg\0syscon";
		reg = <0x00 0x10003000 0x00 0x1000>;
		#clock-cells = <0x01>;
		linux,phandle = <0x69>;
		phandle = <0x69>;
	};

	efuse_dbg@10004000 {
		compatible = "mediatek,efuse_dbg";
		reg = <0x00 0x10004000 0x00 0x1000>;
	};

	smart_pa {
		linux,phandle = <0x6a>;
		phandle = <0x6a>;
	};

	tcpc_pd {
		linux,phandle = <0x6b>;
		phandle = <0x6b>;
	};

	md1_sim1_hot_plug_eint {
		linux,phandle = <0x6c>;
		phandle = <0x6c>;
	};

	md1_sim2_hot_plug_eint {
		linux,phandle = <0x6d>;
		phandle = <0x6d>;
	};

	gpio {
		compatible = "mediatek,gpio_usage_mapping";
		linux,phandle = <0x6e>;
		phandle = <0x6e>;
	};

	gpio@10005000 {
		compatible = "mediatek,gpio";
		reg = <0x00 0x10005000 0x00 0x1000>;
		linux,phandle = <0x6f>;
		phandle = <0x6f>;
	};

	syscfg_pctl_0@10005000 {
		compatible = "mediatek,mt6761-pctl-0-syscfg\0syscon";
		reg = <0x00 0x10005000 0x00 0x1000>;
		linux,phandle = <0x11>;
		phandle = <0x11>;
	};

	sleep@10006000 {
		compatible = "mediatek,sleep";
		reg = <0x00 0x10006000 0x00 0x1000>;
		interrupts = <0x00 0x7d 0x08>;
		wakeup-source = <0x0e 0x00 0x04 0x0f 0x01 0x20 0x10 0x03 0x2000000>;
	};

	pinctrl@1000b000 {
		compatible = "mediatek,mt6761-pinctrl";
		reg = <0x00 0x1000b000 0x00 0x1000>;
		mediatek,pctl-regmap = <0x11 0x12 0x13 0x14 0x15 0x16 0x17 0x18>;
		pins-are-numbered;
		gpio-controller;
		#gpio-cells = <0x02>;
		interrupt-controller;
		#interrupt-cells = <0x04>;
		interrupts = <0x00 0x73 0x04>;
		linux,phandle = <0x37>;
		phandle = <0x37>;

		msdc0@default {
			linux,phandle = <0x2d>;
			phandle = <0x2d>;

			pins_cmd {
				drive-strength = [03];
			};

			pins_dat {
				drive-strength = [03];
			};

			pins_clk {
				drive-strength = [03];
			};

			pins_rst {
				drive-strength = [03];
			};

			pins_ds {
				drive-strength = [03];
			};
		};

		msdc0@hs400 {
			linux,phandle = <0x2e>;
			phandle = <0x2e>;

			pins_cmd {
				drive-strength = [03];
			};

			pins_dat {
				drive-strength = [04];
			};

			pins_clk {
				drive-strength = [04];
			};

			pins_rst {
				drive-strength = [03];
			};

			pins_ds {
				drive-strength = [04];
			};
		};

		msdc0@hs200 {
			linux,phandle = <0x2f>;
			phandle = <0x2f>;

			pins_cmd {
				drive-strength = [03];
			};

			pins_dat {
				drive-strength = [04];
			};

			pins_clk {
				drive-strength = [04];
			};

			pins_rst {
				drive-strength = [03];
			};

			pins_ds {
				drive-strength = [04];
			};
		};

		msdc0@register_default {
			cmd_edge = [00];
			rdata_edge = [00];
			wdata_edge = [00];
			linux,phandle = <0x30>;
			phandle = <0x30>;
		};

		msdc1@default {
			linux,phandle = <0x32>;
			phandle = <0x32>;

			pins_cmd {
				drive-strength = [03];
			};

			pins_dat {
				drive-strength = [03];
			};

			pins_clk {
				drive-strength = [03];
			};
		};

		msdc1@sdr104 {
			linux,phandle = <0x33>;
			phandle = <0x33>;

			pins_cmd {
				drive-strength = [03];
			};

			pins_dat {
				drive-strength = [03];
			};

			pins_clk {
				drive-strength = [03];
			};
		};

		msdc1@sdr50 {
			linux,phandle = <0x34>;
			phandle = <0x34>;

			pins_cmd {
				drive-strength = [03];
			};

			pins_dat {
				drive-strength = [03];
			};

			pins_clk {
				drive-strength = [03];
			};
		};

		msdc1@ddr50 {
			linux,phandle = <0x35>;
			phandle = <0x35>;

			pins_cmd {
				drive-strength = [03];
			};

			pins_dat {
				drive-strength = [03];
			};

			pins_clk {
				drive-strength = [03];
			};
		};

		msdc1@register_default {
			cmd_edge = [00];
			rdata_edge = [00];
			wdata_edge = [00];
			linux,phandle = <0x36>;
			phandle = <0x36>;
		};

		msdc3@default {
			linux,phandle = <0x70>;
			phandle = <0x70>;

			pins_cmd {
				drive-strength = [04];
			};

			pins_dat {
				drive-strength = [04];
			};

			pins_clk {
				drive-strength = [04];
			};
		};

		msdc3@register_default {
			cmd_edge = [01];
			rdata_edge = [01];
			wdata_edge = [01];
			linux,phandle = <0x71>;
			phandle = <0x71>;
		};

		camera_pins_cam0_mclk_on {
			linux,phandle = <0x59>;
			phandle = <0x59>;

			pins_cmd_dat {
				pinmux = <0x6301>;
			};
		};

		camera_pins_cam0_mclk_off {
			linux,phandle = <0x5a>;
			phandle = <0x5a>;

			pins_cmd_dat {
				pinmux = <0x6300>;
			};
		};

		camera_pins_cam1_mclk_on {
			linux,phandle = <0x5b>;
			phandle = <0x5b>;

			pins_cmd_dat {
				pinmux = <0x6401>;
			};
		};

		camera_pins_cam1_mclk_off {
			linux,phandle = <0x5c>;
			phandle = <0x5c>;

			pins_cmd_dat {
				pinmux = <0x6400>;
			};
		};

		camera_pins_cam2_mclk_on {
			linux,phandle = <0x5d>;
			phandle = <0x5d>;
		};

		camera_pins_cam2_mclk_off {
			linux,phandle = <0x5e>;
			phandle = <0x5e>;
		};

		cam0@0 {
			linux,phandle = <0x45>;
			phandle = <0x45>;

			pins_cmd_dat {
				pinmux = <0x6500>;
				slew-rate = <0x01>;
				output-low;
			};
		};

		cam0@1 {
			linux,phandle = <0x46>;
			phandle = <0x46>;

			pins_cmd_dat {
				pinmux = <0x6500>;
				slew-rate = <0x01>;
				output-high;
			};
		};

		cam0@2 {
			linux,phandle = <0x47>;
			phandle = <0x47>;

			pins_cmd_dat {
				pinmux = <0x6100>;
				slew-rate = <0x01>;
				output-low;
			};
		};

		cam0@3 {
			linux,phandle = <0x48>;
			phandle = <0x48>;

			pins_cmd_dat {
				pinmux = <0x6100>;
				slew-rate = <0x01>;
				output-high;
			};
		};

		cam1@0 {
			linux,phandle = <0x49>;
			phandle = <0x49>;

			pins_cmd_dat {
				pinmux = <0x6600>;
				slew-rate = <0x01>;
				output-low;
			};
		};

		cam1@1 {
			linux,phandle = <0x4a>;
			phandle = <0x4a>;

			pins_cmd_dat {
				pinmux = <0x6600>;
				slew-rate = <0x01>;
				output-high;
			};
		};

		cam1@2 {
			linux,phandle = <0x4b>;
			phandle = <0x4b>;

			pins_cmd_dat {
				pinmux = <0x6200>;
				slew-rate = <0x01>;
				output-low;
			};
		};

		cam1@3 {
			linux,phandle = <0x4c>;
			phandle = <0x4c>;

			pins_cmd_dat {
				pinmux = <0x6200>;
				slew-rate = <0x01>;
				output-high;
			};
		};

		cam2@0 {
			linux,phandle = <0x4d>;
			phandle = <0x4d>;
		};

		cam2@1 {
			linux,phandle = <0x4e>;
			phandle = <0x4e>;
		};

		cam2@2 {
			linux,phandle = <0x4f>;
			phandle = <0x4f>;
		};

		cam2@3 {
			linux,phandle = <0x50>;
			phandle = <0x50>;
		};

		cam0@vcamd0 {
			linux,phandle = <0x52>;
			phandle = <0x52>;
		};

		cam0@vcamd1 {
			linux,phandle = <0x51>;
			phandle = <0x51>;
		};

		cam1@vcamd0 {
			linux,phandle = <0x54>;
			phandle = <0x54>;
		};

		cam1@vcamd1 {
			linux,phandle = <0x53>;
			phandle = <0x53>;
		};

		cam1@vcama0 {
			linux,phandle = <0x56>;
			phandle = <0x56>;
		};

		cam1@vcama1 {
			linux,phandle = <0x55>;
			phandle = <0x55>;
		};

		cam2@vcama0 {
			linux,phandle = <0x58>;
			phandle = <0x58>;
		};

		cam2@vcama1 {
			linux,phandle = <0x57>;
			phandle = <0x57>;
		};

		camera_pins_cam0_vcamaf_on {
			linux,phandle = <0x5f>;
			phandle = <0x5f>;

			pins_cmd_dat {
				pinmux = <0xa000>;
				slew-rate = <0x01>;
				output-high;
			};
		};

		camera_pins_cam0_vcamaf_off {
			linux,phandle = <0x60>;
			phandle = <0x60>;

			pins_cmd_dat {
				pinmux = <0xa000>;
				slew-rate = <0x01>;
				output-low;
			};
		};

		camdefault {
			linux,phandle = <0x44>;
			phandle = <0x44>;
		};
	};

	toprgu@10007000 {
		compatible = "mediatek,toprgu";
		reg = <0x00 0x10007000 0x00 0x1000>;
		interrupts = <0x00 0x53 0x00>;
	};

	chipid@08000000 {
		compatible = "mediatek,chipid";
		reg = <0x00 0x8000000 0x00 0x04 0x00 0x8000004 0x00 0x04 0x00 0x8000008 0x00 0x04 0x00 0x800000c 0x00 0x04>;
	};

	mobicore {
		compatible = "trustonic,mobicore";
		interrupts = <0x00 0xc2 0x01>;
	};

	tkcore {
		compatible = "trustkernel,tkcore";
		interrupts = <0x00 0xc4 0x01>;
	};

	timer {
		compatible = "arm,armv8-timer";
		interrupt-parent = <0x0d>;
		interrupts = <0x01 0x0d 0x08 0x01 0x0e 0x08 0x01 0x0b 0x08 0x01 0x0a 0x08>;
		clock-frequency = <0xc65d40>;
	};

	clocks {

		clk26m {
			compatible = "fixed-clock";
			#clock-cells = <0x00>;
			clock-frequency = <0x18cba80>;
			linux,phandle = <0x1b>;
			phandle = <0x1b>;
		};

		clk32k {
			compatible = "fixed-clock";
			#clock-cells = <0x00>;
			clock-frequency = <0x7d00>;
			linux,phandle = <0x1a>;
			phandle = <0x1a>;
		};
	};

	timer@10008000 {
		compatible = "mediatek,apxgpt";
		reg = <0x00 0x10008000 0x00 0x1000>;
		interrupts = <0x00 0x72 0x08>;
		clocks = <0x19 0x87 0x1a>;
		clock-names = "clk13m\0clk32k";
		linux,phandle = <0x72>;
		phandle = <0x72>;
	};

	hacc@1000a000 {
		compatible = "mediatek,hacc";
		reg = <0x00 0x1000a000 0x00 0x1000>;
		interrupts = <0x00 0x85 0x08>;
	};

	apirq@1000b000 {
		compatible = "mediatek,apirq";
		reg = <0x00 0x1000b000 0x00 0x1000>;
		interrupts = <0x00 0x73 0x04>;
	};

	apmixed@1000c000 {
		compatible = "mediatek,apmixed\0syscon";
		reg = <0x00 0x1000c000 0x00 0x1000>;
		#clock-cells = <0x01>;
		linux,phandle = <0x3c>;
		phandle = <0x3c>;
	};

	fhctl@1000ce00 {
		compatible = "mediatek,fhctl";
		reg = <0x00 0x1000ce00 0x00 0x200>;
	};

	pwrap@1000d000 {
		compatible = "mediatek,pwrap";
		reg = <0x00 0x1000d000 0x00 0x1000>;
		interrupts = <0x00 0x7b 0x04>;
	};

	mt-pmic {
		compatible = "mediatek,mt_pmic";
		interrupt-controller;
		linux,phandle = <0x73>;
		phandle = <0x73>;

		mt635x-auxadc {
			compatible = "mediatek,mt635x-auxadc";
			#io-channel-cells = <0x01>;
			linux,phandle = <0x74>;
			phandle = <0x74>;

			batadc {
				channel = <0x00>;
				resistance-ratio = <0x03 0x01>;
				avg-num = <0x80>;
			};

			isense {
				channel = <0x01>;
				resistance-ratio = <0x03 0x01>;
				avg-num = <0x80>;
			};

			vcdt {
				channel = <0x02>;
			};

			bat_temp {
				channel = <0x03>;
				resistance-ratio = <0x01 0x01>;
			};

			chip_temp {
				channel = <0x05>;
			};

			vcore_temp {
				channel = <0x06>;
			};

			vproc_temp {
				channel = <0x07>;
			};

			accdet {
				channel = <0x09>;
			};

			tsx_temp {
				channel = <0x0b>;
				avg-num = <0x80>;
			};

			hpofs_cal {
				channel = <0x0c>;
				avg-num = <0x100>;
			};

			dcxo_temp {
				channel = <0x0d>;
				avg-num = <0x10>;
			};

			vbif {
				channel = <0x0e>;
				resistance-ratio = <0x01 0x01>;
			};
		};

		buck_regulators {

			buck_vs1 {
				regulator-name = "vs1";
				regulator-min-microvolt = <0x124f80>;
				regulator-max-microvolt = <0x2191c0>;
				regulator-ramp-delay = <0x30d4>;
				regulator-enable-ramp-delay = <0xdc>;
				linux,phandle = <0x75>;
				phandle = <0x75>;
			};

			buck_vmodem {
				regulator-name = "vmodem";
				regulator-min-microvolt = <0x7a120>;
				regulator-max-microvolt = <0x123716>;
				regulator-ramp-delay = <0x186a>;
				regulator-enable-ramp-delay = <0xdc>;
				linux,phandle = <0x76>;
				phandle = <0x76>;
			};

			buck_vcore {
				regulator-name = "vcore";
				regulator-min-microvolt = <0x7ea5e>;
				regulator-max-microvolt = <0x1406f4>;
				regulator-ramp-delay = <0x186a>;
				regulator-enable-ramp-delay = <0xdc>;
				linux,phandle = <0x77>;
				phandle = <0x77>;
			};

			buck_vproc {
				regulator-name = "vproc";
				regulator-min-microvolt = <0x7ea5e>;
				regulator-max-microvolt = <0x1406f4>;
				regulator-ramp-delay = <0x186a>;
				regulator-enable-ramp-delay = <0xdc>;
				linux,phandle = <0x78>;
				phandle = <0x78>;
			};

			buck_vpa {
				regulator-name = "vpa";
				regulator-min-microvolt = <0x7a120>;
				regulator-max-microvolt = <0x37b1d0>;
				regulator-ramp-delay = <0xc350>;
				regulator-enable-ramp-delay = <0xdc>;
				linux,phandle = <0x79>;
				phandle = <0x79>;
			};
		};

		ldo_regulators {

			ldo_vfe28 {
				compatible = "regulator-fixed";
				regulator-name = "vfe28";
				regulator-min-microvolt = <0x2ab980>;
				regulator-max-microvolt = <0x2ab980>;
				regulator-enable-ramp-delay = <0x108>;
				linux,phandle = <0x7a>;
				phandle = <0x7a>;
			};

			ldo_vxo22 {
				regulator-name = "vxo22";
				regulator-min-microvolt = <0x2191c0>;
				regulator-max-microvolt = <0x249f00>;
				regulator-enable-ramp-delay = <0x6e>;
				linux,phandle = <0x7b>;
				phandle = <0x7b>;
			};

			ldo_vrf18 {
				compatible = "regulator-fixed";
				regulator-name = "vrf18";
				regulator-min-microvolt = <0x1b7740>;
				regulator-max-microvolt = <0x1b7740>;
				regulator-enable-ramp-delay = <0x6e>;
				linux,phandle = <0x7c>;
				phandle = <0x7c>;
			};

			ldo_vrf12 {
				compatible = "regulator-fixed";
				regulator-name = "vrf12";
				regulator-min-microvolt = <0x124f80>;
				regulator-max-microvolt = <0x124f80>;
				regulator-enable-ramp-delay = <0x6e>;
				linux,phandle = <0x7d>;
				phandle = <0x7d>;
			};

			ldo_vefuse {
				regulator-name = "vefuse";
				regulator-min-microvolt = <0x124f80>;
				regulator-max-microvolt = <0x325aa0>;
				regulator-enable-ramp-delay = <0x108>;
				linux,phandle = <0x7e>;
				phandle = <0x7e>;
			};

			ldo_vcn33_bt {
				regulator-name = "vcn33_bt";
				regulator-min-microvolt = <0x325aa0>;
				regulator-max-microvolt = <0x3567e0>;
				regulator-enable-ramp-delay = <0x108>;
				linux,phandle = <0x7f>;
				phandle = <0x7f>;
			};

			ldo_vcn33_wifi {
				regulator-name = "vcn33_wifi";
				regulator-min-microvolt = <0x325aa0>;
				regulator-max-microvolt = <0x3567e0>;
				regulator-enable-ramp-delay = <0x108>;
				linux,phandle = <0x80>;
				phandle = <0x80>;
			};

			ldo_vcn28 {
				compatible = "regulator-fixed";
				regulator-name = "vcn28";
				regulator-min-microvolt = <0x2ab980>;
				regulator-max-microvolt = <0x2ab980>;
				regulator-enable-ramp-delay = <0x108>;
				linux,phandle = <0x81>;
				phandle = <0x81>;
			};

			ldo_vcn18 {
				compatible = "regulator-fixed";
				regulator-name = "vcn18";
				regulator-min-microvolt = <0x1b7740>;
				regulator-max-microvolt = <0x1b7740>;
				regulator-enable-ramp-delay = <0x108>;
				linux,phandle = <0x82>;
				phandle = <0x82>;
			};

			ldo_vcama {
				regulator-name = "vcama";
				regulator-min-microvolt = <0x2625a0>;
				regulator-max-microvolt = <0x2ab980>;
				regulator-enable-ramp-delay = <0x108>;
				linux,phandle = <0x61>;
				phandle = <0x61>;
			};

			ldo_vcamd {
				regulator-name = "vcamd";
				regulator-min-microvolt = <0xf4240>;
				regulator-max-microvolt = <0x1b7740>;
				regulator-enable-ramp-delay = <0x108>;
				linux,phandle = <0x62>;
				phandle = <0x62>;
			};

			ldo_vcamio {
				compatible = "regulator-fixed";
				regulator-name = "vcamio";
				regulator-min-microvolt = <0x1b7740>;
				regulator-max-microvolt = <0x1b7740>;
				regulator-enable-ramp-delay = <0x108>;
				linux,phandle = <0x63>;
				phandle = <0x63>;
			};

			ldo_vldo28 {
				regulator-name = "vldo28";
				regulator-min-microvolt = <0x2ab980>;
				regulator-max-microvolt = <0x2dc6c0>;
				regulator-enable-ramp-delay = <0x108>;
				linux,phandle = <0x83>;
				phandle = <0x83>;
			};

			ldo_vsram_others {
				regulator-name = "vsram_others";
				regulator-min-microvolt = <0x7ea5e>;
				regulator-max-microvolt = <0x1406f4>;
				regulator-ramp-delay = <0x186a>;
				regulator-enable-ramp-delay = <0x6e>;
				linux,phandle = <0x84>;
				phandle = <0x84>;
			};

			ldo_vsram_proc {
				regulator-name = "vsram_proc";
				regulator-min-microvolt = <0x7ea5e>;
				regulator-max-microvolt = <0x1406f4>;
				regulator-ramp-delay = <0x186a>;
				regulator-enable-ramp-delay = <0x6e>;
				linux,phandle = <0x85>;
				phandle = <0x85>;
			};

			ldo_vaux18 {
				compatible = "regulator-fixed";
				regulator-name = "vaux18";
				regulator-min-microvolt = <0x1b7740>;
				regulator-max-microvolt = <0x1b7740>;
				regulator-enable-ramp-delay = <0x108>;
				linux,phandle = <0x86>;
				phandle = <0x86>;
			};

			ldo_vaud28 {
				compatible = "regulator-fixed";
				regulator-name = "vaud28";
				regulator-min-microvolt = <0x2ab980>;
				regulator-max-microvolt = <0x2ab980>;
				regulator-enable-ramp-delay = <0x108>;
				linux,phandle = <0x87>;
				phandle = <0x87>;
			};

			ldo_vio28 {
				compatible = "regulator-fixed";
				regulator-name = "vio28";
				regulator-min-microvolt = <0x2ab980>;
				regulator-max-microvolt = <0x2ab980>;
				regulator-enable-ramp-delay = <0x108>;
				linux,phandle = <0x88>;
				phandle = <0x88>;
			};

			ldo_vio18 {
				compatible = "regulator-fixed";
				regulator-name = "vio18";
				regulator-min-microvolt = <0x1b7740>;
				regulator-max-microvolt = <0x1b7740>;
				regulator-enable-ramp-delay = <0x108>;
				linux,phandle = <0x89>;
				phandle = <0x89>;
			};

			ldo_vdram {
				regulator-name = "vdram";
				regulator-min-microvolt = <0x10c8e0>;
				regulator-max-microvolt = <0x124f80>;
				regulator-enable-ramp-delay = <0xce4>;
				linux,phandle = <0x8a>;
				phandle = <0x8a>;
			};

			ldo_vmc {
				regulator-name = "vmc";
				regulator-min-microvolt = <0x1b7740>;
				regulator-max-microvolt = <0x325aa0>;
				regulator-enable-ramp-delay = <0x2c>;
				linux,phandle = <0x39>;
				phandle = <0x39>;
			};

			ldo_vmch {
				regulator-name = "vmch";
				regulator-min-microvolt = <0x2c4020>;
				regulator-max-microvolt = <0x325aa0>;
				regulator-enable-ramp-delay = <0x2c>;
				linux,phandle = <0x38>;
				phandle = <0x38>;
			};

			ldo_vemc {
				regulator-name = "vemc";
				regulator-min-microvolt = <0x2c4020>;
				regulator-max-microvolt = <0x325aa0>;
				regulator-enable-ramp-delay = <0x2c>;
				linux,phandle = <0x31>;
				phandle = <0x31>;
			};

			ldo_vsim1 {
				regulator-name = "vsim1";
				regulator-min-microvolt = <0x19f0a0>;
				regulator-max-microvolt = <0x2f4d60>;
				regulator-enable-ramp-delay = <0x108>;
				linux,phandle = <0x8b>;
				phandle = <0x8b>;
			};

			ldo_vsim2 {
				regulator-name = "vsim2";
				regulator-min-microvolt = <0x19f0a0>;
				regulator-max-microvolt = <0x2f4d60>;
				regulator-enable-ramp-delay = <0x108>;
				linux,phandle = <0x8c>;
				phandle = <0x8c>;
			};

			ldo_vibr {
				regulator-name = "vibr";
				regulator-min-microvolt = <0x124f80>;
				regulator-max-microvolt = <0x325aa0>;
				regulator-enable-ramp-delay = <0x2c>;
				linux,phandle = <0x8d>;
				phandle = <0x8d>;
			};

			ldo_vusb33 {
				regulator-name = "vusb33";
				regulator-min-microvolt = <0x2dc6c0>;
				regulator-max-microvolt = <0x2f4d60>;
				regulator-enable-ramp-delay = <0x108>;
				linux,phandle = <0x8e>;
				phandle = <0x8e>;
			};
		};
	};

	scp@10500000 {
		compatible = "mediatek,scp";
		status = "okay";
		reg = <0x00 0x10500000 0x00 0x40000 0x00 0x105c0000 0x00 0x3000 0x00 0x105c4000 0x00 0x1000 0x00 0x105d4000 0x00 0x6000>;
		interrupts = <0x00 0x88 0x04>;
		core_1 = "enable";
		scp_sramSize = <0x40000>;
	};

	scp_dvfs {
		compatible = "mediatek,scp_dvfs";
		clocks = <0x19 0x6c 0x1b 0x19 0x10 0x19 0x1d 0x19 0x04 0x19 0x1a 0x19 0x08 0x19 0x1c>;
		clock-names = "clk_mux\0clk_pll_0\0clk_pll_1\0clk_pll_2\0clk_pll_3\0clk_pll_4\0clk_pll_5\0clk_pll_6";
	};

	sleep_reg_md@1000f000 {
		compatible = "mediatek,sleep_reg_md";
		reg = <0x00 0x1000f000 0x00 0x1000>;
	};

	kp@10010000 {
		compatible = "mediatek,kp";
		reg = <0x00 0x10010000 0x00 0x1000>;
		interrupts = <0x00 0x7c 0x02>;
		linux,phandle = <0x0e>;
		phandle = <0x0e>;
	};

	mrdump_ext_rst {
		compatible = "mediatek, mrdump_ext_rst-eint";
		force_mode = "EINT";
		mode = "IRQ";
		status = "okay";
		linux,phandle = <0x8f>;
		phandle = <0x8f>;
	};

	touch {
		compatible = "mediatek,touch";
		linux,phandle = <0x90>;
		phandle = <0x90>;
	};

	accdet {
		compatible = "mediatek,pmic-accdet";
		linux,phandle = <0x91>;
		phandle = <0x91>;
	};

	fingerprint {
		compatible = "mediatek,goodix-fp";
		linux,phandle = <0x92>;
		phandle = <0x92>;
	};

	mt6357_gauge {
		compatible = "mediatek,mt6357_gauge";
		gauge_name = "gauge";
		alias_name = "mt6357";
	};

	gauge_timer {
		compatible = "mediatek,gauge_timer_service";
	};

	battery {
		compatible = "mediatek,bat_gm30";
		DIFFERENCE_FULLOCV_ITH = <0xc8>;
		SHUTDOWN_1_TIME = <0x05>;
		KEEP_100_PERCENT = <0x01>;
		R_FG_VALUE = <0x0a>;
		EMBEDDED_SEL = <0x00>;
		PMIC_SHUTDOWN_CURRENT = <0x14>;
		FG_METER_RESISTANCE = <0x4b>;
		CAR_TUNE_VALUE = <0x64>;
		PMIC_MIN_VOL = <0x82dc>;
		POWERON_SYSTEM_IBOOT = <0x1f4>;
		SHUTDOWN_GAUGE0_VOLTAGE = <0x84d0>;
		TEMPERATURE_T0 = <0x32>;
		TEMPERATURE_T1 = <0x19>;
		TEMPERATURE_T2 = <0x0a>;
		TEMPERATURE_T3 = <0x00>;
		TEMPERATURE_T4 = <0xfffffff6>;
		g_FG_PSEUDO100_T0 = <0x64>;
		g_FG_PSEUDO100_T1 = <0x64>;
		g_FG_PSEUDO100_T2 = <0x64>;
		g_FG_PSEUDO100_T3 = <0x64>;
		g_FG_PSEUDO100_T4 = <0x64>;
		Q_MAX_SYS_VOLTAGE_BAT0 = <0xd16>;
		Q_MAX_SYS_VOLTAGE_BAT1 = <0xd16>;
		Q_MAX_SYS_VOLTAGE_BAT2 = <0xd16>;
		Q_MAX_SYS_VOLTAGE_BAT3 = <0xd16>;
		battery0_profile_t0_num = <0x64>;
		battery0_profile_t0 = <0x00 0xa9a4 0x00 0x30b 0xa8f0 0x323 0x617 0xa852 0x323 0x922 0xa7c5 0x325 0xc2e 0xa73e 0x325 0xf39 0xa6bc 0x324 0x1244 0xa63f 0x322 0x1550 0xa5c5 0x323 0x185b 0xa54d 0x323 0x1b67 0xa4d8 0x325 0x1e72 0xa465 0x327 0x217d 0xa3f2 0x329 0x2489 0xa37f 0x328 0x2794 0xa30d 0x328 0x2aa0 0xa283 0x32b 0x2dab 0xa20b 0x32e 0x30b6 0xa1a2 0x333 0x33c2 0xa136 0x335 0x36cd 0xa0ca 0x337 0x39d8 0xa060 0x336 0x3ce4 0x9ff7 0x336 0x3fef 0x9f90 0x33a 0x42fb 0x9f2a 0x342 0x4606 0x9ec7 0x341 0x4911 0x9e66 0x344 0x4c1d 0x9e06 0x347 0x4f28 0x9da7 0x348 0x5234 0x9d47 0x349 0x553f 0x9ce8 0x34b 0x584a 0x9c8f 0x34e 0x5b56 0x9c3a 0x351 0x5e61 0x9be4 0x353 0x616d 0x9b93 0x358 0x6478 0x9b42 0x35d 0x6783 0x9af1 0x360 0x6a8f 0x9aa1 0x364 0x6d9a 0x9a53 0x365 0x70a6 0x9a02 0x361 0x73b1 0x99b1 0x36c 0x76bc 0x995a 0x36b 0x79c8 0x98f6 0x364 0x7cd3 0x9885 0x356 0x7fdf 0x9813 0x348 0x82ea 0x97ac 0x33e 0x85f5 0x9756 0x338 0x8901 0x970b 0x334 0x8c0c 0x96c9 0x332 0x8f18 0x968b 0x332 0x9223 0x9652 0x332 0x952e 0x961b 0x331 0x983a 0x95e7 0x331 0x9b45 0x95b5 0x332 0x9e50 0x9589 0x335 0xa15c 0x955c 0x336 0xa467 0x9531 0x338 0xa773 0x9508 0x33a 0xaa7e 0x94e1 0x33c 0xad89 0x94bb 0x33e 0xb095 0x9496 0x340 0xb3a0 0x9473 0x341 0xb6ac 0x9452 0x343 0xb9b7 0x9433 0x343 0xbcc2 0x9415 0x346 0xbfce 0x93f8 0x347 0xc2d9 0x93dc 0x34a 0xc5e5 0x93c1 0x34c 0xc8f0 0x93a6 0x34e 0xcbfb 0x9387 0x34c 0xcf07 0x935f 0x349 0xd212 0x9320 0x33e 0xd51e 0x92d3 0x335 0xd829 0x9293 0x334 0xdb34 0x9267 0x339 0xde40 0x923c 0x33b 0xe14b 0x920e 0x33a 0xe457 0x91df 0x338 0xe762 0x91b9 0x338 0xea6d 0x9197 0x33a 0xed79 0x9178 0x33c 0xf084 0x9155 0x33e 0xf390 0x9128 0x33e 0xf69b 0x90f3 0x33c 0xf9a6 0x90ba 0x33b 0xfcb2 0x9085 0x33b 0xffbd 0x904e 0x33e 0x102c8 0x9007 0x33d 0x105d4 0x8fc5 0x339 0x108df 0x8fa7 0x339 0x10beb 0x8f9d 0x33f 0x10ef6 0x8f91 0x345 0x11201 0x8f81 0x34c 0x1150d 0x8f64 0x355 0x11818 0x8eff 0x359 0x11b24 0x8ddb 0x352 0x11e2f 0x8c28 0x357 0x1213a 0x89e9 0x35f 0x12446 0x86de 0x378 0x12751 0x8262 0x3a8 0x12a5d 0x7b39 0x3fc 0x12d68 0x79b2 0x30e>;
		battery0_profile_t1_num = <0x64>;
		battery0_profile_t1 = <0x00 0xa988 0x00 0x30b 0xa8b7 0x332 0x617 0xa810 0x332 0x922 0xa777 0x333 0xc2e 0xa6f4 0x335 0xf39 0xa666 0x32b 0x1244 0xa5eb 0x32d 0x1550 0xa573 0x332 0x185b 0xa4fd 0x334 0x1b67 0xa48f 0x335 0x1e72 0xa41b 0x335 0x217d 0xa3a8 0x338 0x2489 0xa334 0x338 0x2794 0xa2c0 0x33d 0x2aa0 0xa253 0x33f 0x2dab 0xa1ea 0x344 0x30b6 0xa181 0x34c 0x33c2 0xa118 0x353 0x36cd 0xa0a5 0x34d 0x39d8 0xa03b 0x353 0x3ce4 0x9fd2 0x354 0x3fef 0x9f76 0x35b 0x42fb 0x9f31 0x364 0x4606 0x9f05 0x37b 0x4911 0x9ec5 0x38e 0x4c1d 0x9e45 0x385 0x4f28 0x9d7d 0x37c 0x5234 0x9ccb 0x37f 0x553f 0x9c41 0x383 0x584a 0x9bd3 0x383 0x5b56 0x9b80 0x387 0x5e61 0x9b43 0x385 0x616d 0x9b16 0x391 0x6478 0x9aec 0x397 0x6783 0x9aba 0x39c 0x6a8f 0x9a74 0x398 0x6d9a 0x9a2a 0x391 0x70a6 0x99d6 0x38a 0x73b1 0x9982 0x383 0x76bc 0x992d 0x382 0x79c8 0x98cd 0x373 0x7cd3 0x9864 0x365 0x7fdf 0x97ff 0x357 0x82ea 0x97a8 0x349 0x85f5 0x9750 0x33f 0x8901 0x9706 0x33a 0x8c0c 0x96c1 0x332 0x8f18 0x9682 0x335 0x9223 0x9643 0x331 0x952e 0x9610 0x333 0x983a 0x95df 0x338 0x9b45 0x95aa 0x338 0x9e50 0x9576 0x333 0xa15c 0x9549 0x337 0xa467 0x9528 0x338 0xa773 0x94ff 0x33f 0xaa7e 0x94d5 0x338 0xad89 0x94bf 0x346 0xb095 0x9495 0x346 0xb3a0 0x9476 0x346 0xb6ac 0x9458 0x348 0xb9b7 0x943e 0x353 0xbcc2 0x941a 0x353 0xbfce 0x9405 0x351 0xc2d9 0x93ec 0x34f 0xc5e5 0x93cc 0x353 0xc8f0 0x93b7 0x350 0xcbfb 0x93a1 0x349 0xcf07 0x9381 0x342 0xd212 0x936f 0x348 0xd51e 0x934f 0x348 0xd829 0x933c 0x350 0xdb34 0x9319 0x348 0xde40 0x9300 0x352 0xe14b 0x92d8 0x353 0xe457 0x92ae 0x35a 0xe762 0x928e 0x34d 0xea6d 0x9266 0x34d 0xed79 0x924e 0x353 0xf084 0x9224 0x352 0xf390 0x91fa 0x34d 0xf69b 0x91cd 0x34d 0xf9a6 0x9199 0x351 0xfcb2 0x9164 0x35f 0xffbd 0x9130 0x365 0x102c8 0x90f1 0x364 0x105d4 0x90a2 0x35c 0x108df 0x9060 0x357 0x10beb 0x903f 0x367 0x10ef6 0x9031 0x378 0x11201 0x9026 0x390 0x1150d 0x9014 0x3ad 0x11818 0x8fe5 0x3c9 0x11b24 0x8f7a 0x3ec 0x11e2f 0x8e4f 0x3bb 0x1213a 0x8c82 0x3c0 0x12446 0x8a1c 0x3e5 0x12751 0x86c0 0x420 0x12a5d 0x8159 0x4d9 0x12d68 0x7aa8 0x3c6>;
		battery0_profile_t2_num = <0x64>;
		battery0_profile_t2 = <0x00 0xa963 0x00 0x30b 0xa884 0x4a6 0x617 0xa7db 0x4ad 0x922 0xa74d 0x4b0 0xc2e 0xa6c7 0x4b0 0xf39 0xa647 0x4b4 0x1244 0xa5cb 0x4b0 0x1550 0xa551 0x4b1 0x185b 0xa4db 0x4b5 0x1b67 0xa468 0x4b5 0x1e72 0xa3f6 0x4ba 0x217d 0xa386 0x4bc 0x2489 0xa316 0x4bd 0x2794 0xa2a8 0x4be 0x2aa0 0xa23a 0x4ba 0x2dab 0xa1cd 0x4c0 0x30b6 0xa15f 0x4c3 0x33c2 0xa0f1 0x4c0 0x36cd 0xa085 0x4c7 0x39d8 0xa01e 0x4ce 0x3ce4 0x9fc5 0x4d4 0x3fef 0x9f82 0x4de 0x42fb 0x9f3a 0x4a1 0x4606 0x9ece 0x35f 0x4911 0x9e62 0x36d 0x4c1d 0x9dbb 0x35d 0x4f28 0x9d0a 0x357 0x5234 0x9c76 0x358 0x553f 0x9c03 0x35b 0x584a 0x9bb0 0x362 0x5b56 0x9b74 0x36a 0x5e61 0x9b48 0x375 0x616d 0x9b1f 0x37e 0x6478 0x9ae2 0x37c 0x6783 0x9a96 0x376 0x6a8f 0x9a46 0x375 0x6d9a 0x99f2 0x373 0x70a6 0x999a 0x36f 0x73b1 0x9939 0x365 0x76bc 0x98d4 0x359 0x79c8 0x986e 0x34c 0x7cd3 0x9809 0x33e 0x7fdf 0x97ab 0x334 0x82ea 0x9758 0x32c 0x85f5 0x970c 0x326 0x8901 0x96c7 0x323 0x8c0c 0x9688 0x321 0x8f18 0x964e 0x321 0x9223 0x9618 0x321 0x952e 0x95e5 0x323 0x983a 0x95b5 0x324 0x9b45 0x9589 0x327 0x9e50 0x955f 0x32a 0xa15c 0x9536 0x32c 0xa467 0x950f 0x32f 0xa773 0x94e8 0x331 0xaa7e 0x94c5 0x335 0xad89 0x94a3 0x338 0xb095 0x9481 0x33a 0xb3a0 0x9463 0x33d 0xb6ac 0x9446 0x340 0xb9b7 0x942a 0x341 0xbcc2 0x940e 0x343 0xbfce 0x93f4 0x345 0xc2d9 0x93da 0x347 0xc5e5 0x93c0 0x347 0xc8f0 0x93a5 0x347 0xcbfb 0x9389 0x346 0xcf07 0x936c 0x344 0xd212 0x934e 0x342 0xd51e 0x932d 0x340 0xd829 0x930a 0x33e 0xdb34 0x92e6 0x33b 0xde40 0x92ee 0x35a 0xe14b 0x92e4 0x429 0xe457 0x92c6 0x4d6 0xe762 0x92a7 0x505 0xea6d 0x9285 0x516 0xed79 0x925f 0x525 0xf084 0x9230 0x52b 0xf390 0x91fa 0x53a 0xf69b 0x91c2 0x545 0xf9a6 0x918d 0x54e 0xfcb2 0x9153 0x564 0xffbd 0x910a 0x572 0x102c8 0x90c3 0x57e 0x105d4 0x9096 0x59b 0x108df 0x907e 0x5c0 0x10beb 0x906e 0x5ec 0x10ef6 0x905a 0x627 0x11201 0x903a 0x671 0x1150d 0x8fea 0x6bd 0x11818 0x8f02 0x6e0 0x11b24 0x8d5c 0x716 0x11e2f 0x8b23 0x78e 0x1213a 0x880c 0x84c 0x12446 0x8367 0x915 0x12751 0x7d81 0x5a2 0x12a5d 0x7d3f 0x576 0x12d68 0x7d3f 0x576>;
		battery0_profile_t3_num = <0x64>;
		battery0_profile_t3 = <0x00 0xa923 0x00 0x30b 0xa7ff 0x717 0x617 0xa731 0x737 0x922 0xa688 0x744 0xc2e 0xa5f5 0x749 0xf39 0xa56f 0x74d 0x1244 0xa4f1 0x74e 0x1550 0xa47a 0x751 0x185b 0xa406 0x753 0x1b67 0xa395 0x752 0x1e72 0xa327 0x753 0x217d 0xa2b9 0x757 0x2489 0xa24b 0x758 0x2794 0xa1de 0x75a 0x2aa0 0xa170 0x760 0x2dab 0xa103 0x76e 0x30b6 0xa09b 0x771 0x33c2 0xa037 0x770 0x36cd 0x9fe5 0x774 0x39d8 0x9fae 0x784 0x3ce4 0x9f80 0x799 0x3fef 0x9f32 0x79e 0x42fb 0x9ea4 0x790 0x4606 0x9dd6 0x775 0x4911 0x9cf9 0x75c 0x4c1d 0x9c4a 0x757 0x4f28 0x9bc9 0x758 0x5234 0x9b64 0x75a 0x553f 0x9b10 0x75d 0x584a 0x9ac9 0x761 0x5b56 0x9a8e 0x765 0x5e61 0x9a5a 0x769 0x616d 0x9a2a 0x76c 0x6478 0x99f3 0x769 0x6783 0x99b2 0x761 0x6a8f 0x9967 0x756 0x6d9a 0x9915 0x74a 0x70a6 0x991e 0x74f 0x73b1 0x9891 0x74d 0x76bc 0x9823 0x744 0x79c8 0x97c7 0x73c 0x7cd3 0x9776 0x739 0x7fdf 0x972a 0x735 0x82ea 0x96e4 0x735 0x85f5 0x96a5 0x715 0x8901 0x9668 0x6e5 0x8c0c 0x962f 0x701 0x8f18 0x95f9 0x6ff 0x9223 0x95c7 0x6fe 0x952e 0x959a 0x707 0x983a 0x956f 0x712 0x9b45 0x9545 0x718 0x9e50 0x951e 0x71c 0xa15c 0x94f7 0x723 0xa467 0x94d4 0x736 0xa773 0x94b0 0x741 0xaa7e 0x9491 0x74c 0xad89 0x9471 0x755 0xb095 0x9454 0x75c 0xb3a0 0x943a 0x762 0xb6ac 0x9431 0x77a 0xb9b7 0x940e 0x790 0xbcc2 0x93f3 0x7a0 0xbfce 0x93dc 0x7ad 0xc2d9 0x93c9 0x7b7 0xc5e5 0x93b8 0x7c2 0xc8f0 0x93a9 0x7cc 0xcbfb 0x9399 0x7d6 0xcf07 0x9389 0x7e1 0xd212 0x9377 0x7ee 0xd51e 0x9363 0x7fc 0xd829 0x934e 0x80c 0xdb34 0x9337 0x81a 0xde40 0x931d 0x829 0xe14b 0x9302 0x839 0xe457 0x9318 0x7e7 0xe762 0x92db 0x813 0xea6d 0x92b2 0x83b 0xed79 0x9285 0x85d 0xf084 0x9254 0x87d 0xf390 0x921e 0x8a0 0xf69b 0x91e8 0x8c4 0xf9a6 0x91b0 0x8ea 0xfcb2 0x9170 0x910 0xffbd 0x9128 0x936 0x102c8 0x90e4 0x960 0x105d4 0x90b3 0x998 0x108df 0x9094 0x9e3 0x10beb 0x907b 0xa3f 0x10ef6 0x9061 0xaae 0x11201 0x9069 0x944 0x1150d 0x9025 0x979 0x11818 0x8f57 0xa44 0x11b24 0x8dbf 0xb32 0x11e2f 0x8b86 0xc96 0x1213a 0x8882 0xd13 0x12446 0x8453 0xa3f 0x12751 0x8073 0x7a2 0x12a5d 0x8073 0x7a2 0x12d68 0x8073 0x7a2>;
		battery0_profile_t4_num = <0x64>;
		battery0_profile_t4 = <0x00 0xa881 0x00 0x30b 0xa741 0xecd 0x617 0xa674 0xef5 0x922 0xa5d0 0xefc 0xc2e 0xa540 0xefb 0xf39 0xa4bc 0xef7 0x1244 0xa444 0xef2 0x1550 0xa3cd 0xeec 0x185b 0xa359 0xee6 0x1b67 0xa2e8 0xedf 0x1e72 0xa276 0xed7 0x217d 0xa204 0xecf 0x2489 0xa195 0xeca 0x2794 0xa126 0xea6 0x2aa0 0xa0ba 0xeb4 0x2dab 0x9bfa 0xbc9 0x30b6 0x9ac9 0xe1e 0x33c2 0x9a35 0xe9e 0x36cd 0x99b3 0xe83 0x39d8 0x9959 0xe76 0x3ce4 0x990c 0xe6a 0x3fef 0x98c3 0xe5f 0x42fb 0x987b 0xe54 0x4606 0x982f 0xe45 0x4911 0x97e3 0xe3d 0x4c1d 0x9797 0xe39 0x4f28 0x974e 0xe36 0x5234 0x9708 0xe33 0x553f 0x96c5 0xe31 0x584a 0x9685 0xe30 0x5b56 0x9649 0xe30 0x5e61 0x9610 0xe2f 0x616d 0x95da 0xe2d 0x6478 0x95a6 0xe2f 0x6783 0x9578 0xe35 0x6a8f 0x954b 0xe3b 0x6d9a 0x951f 0xe3c 0x70a6 0x94f5 0xe40 0x73b1 0x94cd 0xe43 0x76bc 0x94aa 0xe02 0x79c8 0x94b1 0xe51 0x7cd3 0x947e 0xe61 0x7fdf 0x9455 0xe6e 0x82ea 0x9432 0xe7c 0x85f5 0x9414 0xe8a 0x8901 0x93f8 0xe98 0x8c0c 0x93df 0xea6 0x8f18 0x93c9 0xeb4 0x9223 0x93b3 0xec5 0x952e 0x939e 0xedb 0x983a 0x9389 0xef5 0x9b45 0x9374 0xf0c 0x9e50 0x935d 0xf23 0xa15c 0x9345 0xf3c 0xa467 0x932d 0xe56 0xa773 0x938b 0xef3 0xaa7e 0x9352 0xf3f 0xad89 0x9318 0xf7c 0xb095 0x92e6 0xfae 0xb3a0 0x92b9 0xfe0 0xb6ac 0x928e 0x1014 0xb9b7 0x9264 0x1047 0xbcc2 0x9234 0x1077 0xbfce 0x9202 0x10af 0xc2d9 0x91cc 0x10eb 0xc5e5 0x9195 0x112e 0xc8f0 0x915f 0x1179 0xcbfb 0x912f 0x11ce 0xcf07 0x9104 0x1231 0xd212 0x90de 0x1040 0xd51e 0x90eb 0x1057 0xd829 0x90c5 0x11da 0xdb34 0x907f 0x127a 0xde40 0x903e 0x124d 0xe14b 0x8fdf 0x120e 0xe457 0x8f32 0x1199 0xe762 0x8df3 0x10c1 0xea6d 0x8d7c 0x1071 0xed79 0x8a70 0xe61 0xf084 0x87b2 0xc86 0xf390 0x84b2 0xa7d 0xf69b 0x84b2 0xa7d 0xf9a6 0x84b2 0xa7d 0xfcb2 0x84b2 0xa7d 0xffbd 0x84b2 0xa7d 0x102c8 0x84b2 0xa7d 0x105d4 0x84b2 0xa7d 0x108df 0x84b2 0xa7d 0x10beb 0x84b2 0xa7d 0x10ef6 0x84b2 0xa7d 0x11201 0x84b2 0xa7d 0x1150d 0x84b2 0xa7d 0x11818 0x84b2 0xa7d 0x11b24 0x84b2 0xa7d 0x11e2f 0x84b2 0xa7d 0x1213a 0x84b2 0xa7d 0x12446 0x84b2 0xa7d 0x12751 0x84b2 0xa7d 0x12a5d 0x84b2 0xa7d 0x12d68 0x84b2 0xa7d>;
		linux,phandle = <0x93>;
		phandle = <0x93>;
	};

	topmisc@10011000 {
		compatible = "mediatek,topmisc";
		reg = <0x00 0x10011000 0x00 0x1000>;
	};

	dvfsrc@10012000 {
		compatible = "mediatek,dvfsrc";
		reg = <0x00 0x10012000 0x00 0x1000 0x00 0x110780 0x00 0x80>;
	};

	mbist_ao@10013000 {
		compatible = "mediatek,mbist_ao";
		reg = <0x00 0x10013000 0x00 0x1000>;
	};

	apcldmain_ao@10014000 {
		compatible = "mediatek,apcldmain_ao";
		reg = <0x00 0x10014000 0x00 0x400>;
	};

	apcldmaout_ao@10014400 {
		compatible = "mediatek,apcldmaout_ao";
		reg = <0x00 0x10014400 0x00 0x400>;
	};

	apcldmamisc_ao@10014800 {
		compatible = "mediatek,apcldmamisc_ao";
		reg = <0x00 0x10014800 0x00 0x400>;
	};

	apcldmamisc_ao@10014c00 {
		compatible = "mediatek,apcldmamisc_ao";
		reg = <0x00 0x10014c00 0x00 0x400>;
	};

	aes_top0@10016000 {
		compatible = "mediatek,aes_top0";
		reg = <0x00 0x10016000 0x00 0x1000>;
	};

	sys_timer@10017000 {
		compatible = "mediatek,sys_timer";
		reg = <0x00 0x10017000 0x00 0x1000>;
		reg-names = "sys_timer_base";
		interrupts = <0x00 0x8a 0x04>;
	};

	modem_temp_share@10018000 {
		compatible = "mediatek,modem_temp_share";
		reg = <0x00 0x10018000 0x00 0x1000>;
	};

	security_ao@1001a000 {
		compatible = "mediatek,security_ao";
		reg = <0x00 0x1001a000 0x00 0x1000>;
	};

	topckgen_ao@1001b000 {
		compatible = "mediatek,topckgen_ao";
		reg = <0x00 0x1001b000 0x00 0x1000>;
	};

	iocfg_0@10002000 {
		compatible = "mediatek,iocfg_0";
		reg = <0x00 0x10002000 0x00 0x200>;
	};

	iocfg_1@10002200 {
		compatible = "mediatek,iocfg_1";
		reg = <0x00 0x10002200 0x00 0x200>;
	};

	iocfg_2@10002400 {
		compatible = "mediatek,iocfg_2";
		reg = <0x00 0x10002400 0x00 0x200>;
	};

	iocfg_3@10002600 {
		compatible = "mediatek,iocfg_3";
		reg = <0x00 0x10002600 0x00 0x200>;
	};

	iocfg_4@10002800 {
		compatible = "mediatek,iocfg_4";
		reg = <0x00 0x10002800 0x00 0x200>;
	};

	iocfg_5@10002a00 {
		compatible = "mediatek,iocfg_5";
		reg = <0x00 0x10002a00 0x00 0x200>;
	};

	mdcldmain_ao@10015000 {
		compatible = "mediatek,mdcldmain_ao";
		reg = <0x00 0x10015000 0x00 0x400>;
	};

	mdcldmaout_ao@10015400 {
		compatible = "mediatek,mdcldmaout_ao";
		reg = <0x00 0x10015400 0x00 0x400>;
	};

	mdcldmamisc_ao@10015800 {
		compatible = "mediatek,mdcldmamisc_ao";
		reg = <0x00 0x10015800 0x00 0x400>;
	};

	sys_cirq@10204000 {
		compatible = "mediatek,sys_cirq";
		reg = <0x00 0x10204000 0x00 0x1000>;
		mediatek,cirq_num = <0xd1>;
		mediatek,spi_start_offset = <0x10>;
		interrupts = <0x00 0xe0 0x08>;
	};

	mcucfg@10200000 {
		compatible = "mediatek,mcucfg";
		reg = <0x00 0x10200000 0x00 0x200>;
		interrupts = <0x00 0x00 0x04>;
	};

	mcucfg@10200200 {
		compatible = "mediatek,mcucfg";
		reg = <0x00 0x10200200 0x00 0x200>;
		interrupts = <0x00 0x01 0x08>;
	};

	mcucfg@10200400 {
		compatible = "mediatek,mcucfg";
		reg = <0x00 0x10200400 0x00 0x200>;
		interrupts = <0x00 0x02 0x04>;
	};

	mcucfg@10200600 {
		compatible = "mediatek,mcucfg";
		reg = <0x00 0x10200600 0x00 0x200>;
		interrupts = <0x00 0x03 0x04>;
	};

	mcucfg@10200800 {
		compatible = "mediatek,mcucfg";
		reg = <0x00 0x10200800 0x00 0x200>;
		interrupts = <0x00 0x04 0x04>;
	};

	mcucfg@10200a00 {
		compatible = "mediatek,mcucfg";
		reg = <0x00 0x10200a00 0x00 0x300>;
		interrupts = <0x00 0x05 0x08>;
	};

	mcucfg@10200f00 {
		compatible = "mediatek,mcucfg";
		reg = <0x00 0x10200f00 0x00 0x100>;
		interrupts = <0x00 0x06 0x08>;
	};

	mcucfg@10201000 {
		compatible = "mediatek,mcucfg";
		reg = <0x00 0x10201000 0x00 0x1000>;
		interrupts = <0x00 0x07 0x08>;
	};

	mcucfg@10202000 {
		compatible = "mediatek,mcucfg";
		reg = <0x00 0x10202000 0x00 0x1000>;
		interrupts = <0x00 0x08 0x08>;
	};

	mcucfg@10203000 {
		compatible = "mediatek,mcucfg";
		reg = <0x00 0x10203000 0x00 0x1000>;
		interrupts = <0x00 0x09 0x08>;
	};

	mcucfg_mp0_counter@10200000 {
		compatible = "mediatek,mcucfg_mp0_counter";
		reg = <0x00 0x10200000 0x00 0x4000>;
	};

	m4u@10205000 {
		cell-index = <0x00>;
		compatible = "mediatek,iommu_v0";
		reg = <0x00 0x10205000 0x00 0x1000>;
		mediatek,larbs = <0x1c 0x1d 0x1e>;
		interrupts = <0x00 0x9e 0x08>;
		#iommu-cells = <0x01>;
		linux,phandle = <0x65>;
		phandle = <0x65>;
	};

	devapc@10207000 {
		compatible = "mediatek,devapc";
		reg = <0x00 0x10207000 0x00 0x1000>;
		interrupts = <0x00 0x56 0x08>;
		clocks = <0x1f 0x28>;
		clock-names = "devapc-infra-clock";
	};

	bus_dbg@10208000 {
		compatible = "mediatek,bus_dbg-v2";
		reg = <0x00 0x10208000 0x00 0x1000 0x00 0x10001000 0x00 0x1000>;
		mediatek,bus_dbg_con_offset = <0x2fc>;
		interrupts = <0x00 0x55 0x08>;
	};

	ap_ccif0@10209000 {
		compatible = "mediatek,ap_ccif0";
		reg = <0x00 0x10209000 0x00 0x1000>;
		interrupts = <0x00 0x5c 0x08>;
	};

	md_ccif0@1020a000 {
		compatible = "mediatek,md_ccif0";
		reg = <0x00 0x1020a000 0x00 0x1000>;
	};

	ap_ccif1@1020b000 {
		compatible = "mediatek,ap_ccif1";
		reg = <0x00 0x1020b000 0x00 0x1000>;
		interrupts = <0x00 0x5e 0x08>;
	};

	md_ccif1@1020c000 {
		compatible = "mediatek,md_ccif1";
		reg = <0x00 0x1020c000 0x00 0x1000>;
	};

	infra_mbist@1020d000 {
		compatible = "mediatek,infra_mbist";
		reg = <0x00 0x1020d000 0x00 0x1000>;
	};

	infracfg@1020e000 {
		compatible = "mediatek,infracfg";
		reg = <0x00 0x1020e000 0x00 0x1000>;
	};

	trng@1020f000 {
		compatible = "mediatek,trng";
		reg = <0x00 0x1020f000 0x00 0x1000>;
		interrupts = <0x00 0x69 0x08>;
	};

	dxcc_sec@10210000 {
		compatible = "mediatek,dxcc_sec";
		reg = <0x00 0x10210000 0x00 0x1000>;
		interrupts = <0x00 0x6a 0x04>;
	};

	mcupm_sram2@10211000 {
		compatible = "mediatek,mcupm_sram2";
		reg = <0x00 0x10211000 0x00 0x1000>;
	};

	cq_dma@10212000 {
		compatible = "mediatek,mt-cqdma-v1";
		reg = <0x00 0x10212000 0x00 0x80 0x00 0x10212080 0x00 0x80 0x00 0x10212100 0x00 0x68>;
		interrupts = <0x00 0x39 0x08 0x00 0x3a 0x08 0x00 0x3b 0x08>;
		nr_channel = <0x03>;
		keep_clock_ao = "yes";
		clocks = <0x1f 0x43>;
		clock-names = "cqdma";
	};

	mcupm_sram3@10213000 {
		compatible = "mediatek,mcupm_sram3";
		reg = <0x00 0x10213000 0x00 0x1000>;
	};

	sramrom@10214000 {
		compatible = "mediatek,sramrom";
		reg = <0x00 0x10214000 0x00 0x1000>;
	};

	mcupm_reg@10216000 {
		compatible = "mediatek,mcupm_reg";
		reg = <0x00 0x10216000 0x00 0x1000>;
	};

	mcupm_sram0@10217000 {
		compatible = "mediatek,mcupm_sram0";
		reg = <0x00 0x10217000 0x00 0x1000>;
	};

	mcupm_sram1@10218000 {
		compatible = "mediatek,mcupm_sram1";
		reg = <0x00 0x10218000 0x00 0x1000>;
	};

	emi@10219000 {
		compatible = "mediatek,emi";
		reg = <0x00 0x10219000 0x00 0x1000 0x00 0x10226000 0x00 0x1000 0x00 0x1022d000 0x00 0x1000 0x00 0x10235000 0x00 0x1000>;
		interrupts = <0x00 0x58 0x08>;
	};

	apcldmain@1021b000 {
		compatible = "mediatek,apcldmain";
		reg = <0x00 0x1021b000 0x00 0x100>;
	};

	apcldmaout@1021b400 {
		compatible = "mediatek,apcldmaout";
		reg = <0x00 0x1021b400 0x00 0x100>;
	};

	apcldmamisc@1021b800 {
		compatible = "mediatek,apcldmamisc";
		reg = <0x00 0x1021b800 0x00 0x100>;
		interrupts = <0x00 0x6d 0x04>;
	};

	mdcldmain@1021c000 {
		compatible = "mediatek,mdcldmain";
		reg = <0x00 0x1021c000 0x00 0x400>;
	};

	mdcldmaout@1021c400 {
		compatible = "mediatek,mdcldmaout";
		reg = <0x00 0x1021c400 0x00 0x400>;
	};

	mdcldmamisc@1021c800 {
		compatible = "mediatek,mdcldmamisc";
		reg = <0x00 0x1021c800 0x00 0x1000>;
	};

	mdcldma@10014000 {
		compatible = "mediatek,mdcldma";
		reg = <0x00 0x10014000 0x00 0x1000 0x00 0x1021b000 0x00 0x1000 0x00 0x10209000 0x00 0x1000 0x00 0x1020a000 0x00 0x1000>;
		interrupts = <0x00 0x6d 0x04 0x00 0x5c 0x08 0x00 0x5d 0x08 0x00 0xcd 0x02>;
		mediatek,md_id = <0x00>;
		mediatek,cldma_capability = <0x06>;
		clocks = <0x20 0x00 0x1f 0x32 0x1f 0x29 0x1f 0x2c 0x1f 0x23 0x1f 0x24 0x1f 0x58 0x1f 0x59>;
		clock-names = "scp-sys-md1-main\0infra-cldma-bclk\0infra-ccif-ap\0infra-ccif-md\0infra-ccif1-ap\0infra-ccif1-md\0infra-ccif2-ap\0infra-ccif2-md";
		linux,phandle = <0x10>;
		phandle = <0x10>;
	};

	bpi_bsi_slv0@1021e000 {
		compatible = "mediatek,bpi_bsi_slv0";
		reg = <0x00 0x1021e000 0x00 0x1000>;
	};

	bpi_bsi_slv1@1021f000 {
		compatible = "mediatek,bpi_bsi_slv1";
		reg = <0x00 0x1021f000 0x00 0x6000>;
	};

	bpi_bsi_slv2@10225000 {
		compatible = "mediatek,bpi_bsi_slv2";
		reg = <0x00 0x10225000 0x00 0x1000>;
	};

	dvfsp@10227000 {
		compatible = "mediatek,dvfsp";
		reg = <0x00 0x10227000 0x00 0x1000>;
	};

	dvfsp@00110800 {
		compatible = "mediatek,mt6761-dvfsp";
		reg = <0x00 0x110800 0x00 0x1400 0x00 0x110800 0x00 0x1400>;
	};

	dramc@1022a000 {
		compatible = "mediatek,dramc";
		reg = <0x00 0x1022a000 0x00 0x2000 0x00 0x10232000 0x00 0x2000 0x00 0x1022c000 0x00 0x1000 0x00 0x10234000 0x00 0x1000 0x00 0x10228000 0x00 0x2000 0x00 0x10230000 0x00 0x2000 0x00 0x1022e000 0x00 0x1000 0x00 0x10236000 0x00 0x1000>;
	};

	gce@10238000 {
		compatible = "mediatek,gce\0syscon";
		reg = <0x00 0x10238000 0x00 0x4000>;
		#clock-cells = <0x01>;
		interrupts = <0x00 0x62 0x08>;
		g3d_config_base = <0x13000000 0x00 0xffff0000>;
		mmsys_config_base = <0x14000000 0x01 0xffff0000>;
		disp_dither_base = <0x14010000 0x02 0xffff0000>;
		mm_na_base = <0x14020000 0x03 0xffff0000>;
		imgsys_base = <0x15020000 0x04 0xffff0000>;
		vdec_gcon_base = <0x18800000 0x05 0xffff0000>;
		venc_gcon_base = <0x18810000 0x06 0xffff0000>;
		conn_peri_base = <0x18820000 0x07 0xffff0000>;
		topckgen_base = <0x18830000 0x08 0xffff0000>;
		kp_base = <0x18840000 0x09 0xffff0000>;
		scp_sram_base = <0x10000000 0x0a 0xffff0000>;
		infra_na3_base = <0x10010000 0x0b 0xffff0000>;
		infra_na4_base = <0x10020000 0x0c 0xffff0000>;
		scp_base = <0x10030000 0x0d 0xffff0000>;
		mcucfg_base = <0x10040000 0x0e 0xffff0000>;
		gcpu_base = <0x10050000 0x0f 0xffff0000>;
		usb0_base = <0x10200000 0x10 0xffff0000>;
		usb_sif_base = <0x10280000 0x11 0xffff0000>;
		audio_base = <0x17000000 0x12 0xffff0000>;
		vdec_base = <0x17010000 0x13 0xffff0000>;
		msdc2_base = <0x17020000 0x14 0xffff0000>;
		vdec1_base = <0x17030000 0x15 0xffff0000>;
		msdc3_base = <0x18000000 0x16 0xffff0000>;
		ap_dma_base = <0x18010000 0x17 0xffff0000>;
		gce_base = <0x18020000 0x18 0xffff0000>;
		vdec2_base = <0x18040000 0x19 0xffff0000>;
		vdec3_base = <0x18050000 0x1a 0xffff0000>;
		camsys_base = <0x18080000 0x1b 0xffff0000>;
		camsys1_base = <0x180a0000 0x1c 0xffff0000>;
		camsys2_base = <0x180b0000 0x1d 0xffff0000>;
		pwm_sw_base = <0x1100e000 0x63 0xffff0000>;
		mipitx0_base = <0x11c80000 0x63 0xffff0000>;
		mdp_rdma0_sof = <0x00>;
		mdp_ccorr0_sof = <0x01>;
		mdp_rsz0_sof = <0x02>;
		mdp_rsz1_sof = <0x03>;
		mdp_wdma_sof = <0x04>;
		mdp_wrot0_sof = <0x05>;
		mdp_tdshp0_sof = <0x06>;
		disp_ovl0_sof = <0x07>;
		disp_2l_ovl0_sof = <0x08>;
		disp_rdma0_sof = <0x09>;
		disp_wdma0_sof = <0x0a>;
		disp_color0_sof = <0x0b>;
		disp_ccorr0_sof = <0x0c>;
		disp_aal0_sof = <0x0d>;
		disp_gamma0_sof = <0x0e>;
		disp_dither0_sof = <0x0f>;
		disp_dsi0_sof = <0x10>;
		disp_rsz0_sof = <0x11>;
		img_dl_relay_sof = <0x12>;
		disp_pwm0_sof = <0x13>;
		mdp_rdma0_frame_done = <0x14>;
		mdp_ccorr0_frame_done = <0x15>;
		mdp_rsz0_frame_done = <0x16>;
		mdp_rsz1_frame_done = <0x17>;
		mdp_wrot0_write_frame_done = <0x18>;
		mdp_wdma_frame_done = <0x19>;
		mdp_tdshp0_frame_done = <0x1a>;
		disp_ovl0_frame_done = <0x1b>;
		disp_2l_ovl0_frame_done = <0x1c>;
		disp_rsz0_frame_done = <0x1d>;
		disp_rdma0_frame_done = <0x1e>;
		disp_wdma0_frame_done = <0x1f>;
		disp_color0_frame_done = <0x20>;
		disp_ccorr0_frame_done = <0x21>;
		disp_aal0_frame_done = <0x22>;
		disp_gamma0_frame_done = <0x23>;
		disp_dither0_frame_done = <0x24>;
		disp_dsi0_frame_done = <0x25>;
		stream_done_0 = <0x82>;
		stream_done_1 = <0x83>;
		stream_done_2 = <0x84>;
		stream_done_3 = <0x85>;
		stream_done_4 = <0x86>;
		stream_done_5 = <0x87>;
		stream_done_6 = <0x88>;
		stream_done_7 = <0x89>;
		stream_done_8 = <0x8a>;
		stream_done_9 = <0x8b>;
		buf_underrun_event_0 = <0x8c>;
		dsi0_te_event = <0x8d>;
		dsi0_irq_event = <0x8e>;
		dsi0_done_event = <0x8f>;
		disp_wdma0_rst_done = <0x93>;
		mdp_wdma_rst_done = <0x94>;
		mdp_wrot0_rst_done = <0x95>;
		mdp_rdma0_rst_done = <0x97>;
		disp_ovl0_frame_rst_done_pusle = <0x98>;
		dip_cq_thread2_frame_done = <0x101>;
		dip_cq_thread1_frame_done = <0x102>;
		dip_cq_thread0_frame_done = <0x103>;
		isp_frame_done_p1_1 = <0x104>;
		isp_frame_done_p1_0 = <0x105>;
		camsv_0_pass1_done = <0x106>;
		camsv_1_pass1_done = <0x107>;
		seninf_0_fifo_full = <0x108>;
		seninf_1_fifo_full = <0x109>;
		seninf_2_fifo_full = <0x10a>;
		seninf_3_fifo_full = <0x10b>;
		seninf_4_fifo_full = <0x10c>;
		seninf_5_fifo_full = <0x10d>;
		seninf_6_fifo_full = <0x10e>;
		seninf_7_fifo_full = <0x10f>;
		venc_done = <0x121>;
		jpgenc_done = <0x122>;
		jpgdec_done = <0x123>;
		venc_mb_done = <0x124>;
		venc_128byte_cnt_done = <0x125>;
		max_prefetch_cnt = <0x01>;
		prefetch_size = <0x60>;
		sram_size_cpr_64 = <0x40>;
		mmsys_config = <0x21>;
		mdp_rdma0 = <0x22>;
		mdp_rsz0 = <0x23>;
		mdp_rsz1 = <0x24>;
		mdp_wdma0 = <0x25>;
		mdp_wrot0 = <0x26>;
		mdp_tdshp0 = <0x27>;
		mdp_color0 = <0x28>;
		mdp_ccorr0 = <0x29>;
		mm_mutex = <0x2a>;
		sram_share_cnt = <0x01>;
		sram_share_engine = <0x0a>;
		sram_share_event = <0x2c6>;
		clocks = <0x1f 0x09 0x1f 0x18>;
		clock-names = "GCE\0GCE_TIMER";
		mediatek,mailbox-gce = <0x2b>;
		thread_count = <0x10>;
		secure_thread = <0x08 0x0a>;
		mboxes = <0x2b 0x00 0x00 0x04 0x2b 0x01 0x00 0x04 0x2b 0x02 0x00 0x05 0x2b 0x03 0x00 0x04 0x2b 0x04 0x00 0x04 0x2b 0x05 0x00 0x04 0x2b 0x06 0xc8 0x03 0x2b 0x07 0xffffffff 0x02 0x2b 0x08 0x00 0x01 0x2b 0x09 0x00 0x01 0x2b 0x0a 0x00 0x01 0x2b 0x0b 0x00 0x01 0x2b 0x0c 0x00 0x01 0x2b 0x0d 0x00 0x01 0x2b 0x0e 0x00 0x01 0x2b 0x0f 0x00 0x01>;
		linux,phandle = <0x94>;
		phandle = <0x94>;
	};

	gce_mbox@10238000 {
		compatible = "mediatek,mailbox-gce";
		reg = <0x00 0x10238000 0x00 0x4000>;
		interrupts = <0x00 0x62 0x08>;
		#mbox-cells = <0x03>;
		#gce-event-cells = <0x01>;
		#gce-subsys-cells = <0x02>;
		clocks = <0x1f 0x09 0x1f 0x18>;
		clock-names = "gce\0GCE_TIMER";
		linux,phandle = <0x2b>;
		phandle = <0x2b>;
	};

	ap_ccif2@1023c000 {
		compatible = "mediatek,ap_ccif2";
		reg = <0x00 0x1023c000 0x00 0x1000>;
		interrupts = <0x00 0x57 0x08>;
	};

	md_ccif2@1023d000 {
		compatible = "mediatek,md_ccif2";
		reg = <0x00 0x1023d000 0x00 0x1000>;
	};

	ap_ccif3@1023e000 {
		compatible = "mediatek,ap_ccif3";
		reg = <0x00 0x1023e000 0x00 0x1000>;
		interrupts = <0x00 0x5a 0x08>;
	};

	md_ccif3@1023f000 {
		compatible = "mediatek,md_ccif3";
		reg = <0x00 0x1023f000 0x00 0x1000>;
	};

	sspm@10440000 {
		compatible = "mediatek,sspm";
		reg = <0x00 0x10440000 0x00 0x10000 0x00 0x10450000 0x00 0x100 0x00 0x10451000 0x00 0x08 0x00 0x10460000 0x00 0x100 0x00 0x10461000 0x00 0x08 0x00 0x10470000 0x00 0x100 0x00 0x10471000 0x00 0x08 0x00 0x10480000 0x00 0x100 0x00 0x10481000 0x00 0x08 0x00 0x10490000 0x00 0x100 0x00 0x10491000 0x00 0x08>;
		reg-names = "cfgreg\0mbox0_base\0mbox0_ctrl\0mbox1_base\0mbox1_ctrl\0mbox2_base\0mbox2_ctrl\0mbox3_base\0mbox3_ctrl\0mbox4_base\0mbox4_ctrl";
		interrupts = <0x00 0x92 0x04 0x00 0x95 0x04 0x00 0x96 0x04 0x00 0x97 0x04 0x00 0x98 0x04 0x00 0x99 0x04>;
		interrupt-names = "ipc\0mbox0\0mbox1\0mbox2\0mbox3\0mbox4";
	};

	gic500@0c000000 {
		compatible = "mediatek,gic500";
		reg = <0x00 0xc000000 0x00 0x400000>;
	};

	gic_cpu@0c400000 {
		compatible = "mediatek,gic_cpu";
		reg = <0x00 0xc400000 0x00 0x40000>;
	};

	dfd@10200b00 {
		compatible = "mediatek,dfd";
		reg = <0x00 0x10200b00 0x00 0x10000>;
		mediatek,enabled = <0x01>;
		mediatek,chain_length = <0x61a8>;
		mediatek,rg_dfd_timeout = <0xa0>;
	};

	dbg_cti@0d020000 {
		compatible = "mediatek,dbg_cti";
		reg = <0x00 0xd020000 0x00 0x10000>;
	};

	dbg_etr@0d030000 {
		compatible = "mediatek,dbg_etr";
		reg = <0x00 0xd030000 0x00 0x10000>;
	};

	dbg_funnel@0d040000 {
		compatible = "mediatek,dbg_funnel";
		reg = <0x00 0xd040000 0x00 0x10000>;
	};

	dbg_dem@0d0a0000 {
		compatible = "mediatek,dbg_dem";
		reg = <0x00 0xd0a0000 0x00 0x10000>;
		interrupts = <0x00 0x54 0x08>;
	};

	dbg_mdsys1@0d0c0000 {
		compatible = "mediatek,dbg_mdsys1";
		reg = <0x00 0xd0c0000 0x00 0x40000>;
	};

	dbg_apmcu_mp0@0d400000 {
		compatible = "mediatek,dbg_apmcu_mp0";
		reg = <0x00 0xd400000 0x00 0x1000>;
	};

	dbg_apmcu_mp0@0d410000 {
		compatible = "mediatek,dbg_apmcu_mp0";
		reg = <0x00 0xd410000 0x00 0x1000>;
	};

	dbg_apmcu_mp0@0d420000 {
		compatible = "mediatek,dbg_apmcu_mp0";
		reg = <0x00 0xd420000 0x00 0x1000>;
	};

	dbg_apmcu_mp0@0d430000 {
		compatible = "mediatek,dbg_apmcu_mp0";
		reg = <0x00 0xd430000 0x00 0x1000>;
	};

	dbg_apmcu_mp0@0d440000 {
		compatible = "mediatek,dbg_apmcu_mp0";
		reg = <0x00 0xd440000 0x00 0x1000>;
	};

	dbg_apmcu_mp0@0d510000 {
		compatible = "mediatek,dbg_apmcu_mp0";
		reg = <0x00 0xd510000 0x00 0x1000>;
	};

	dbg_apmcu_mp0@0d520000 {
		compatible = "mediatek,dbg_apmcu_mp0";
		reg = <0x00 0xd520000 0x00 0x1000>;
	};

	dbg_apmcu_mp0@0d530000 {
		compatible = "mediatek,dbg_apmcu_mp0";
		reg = <0x00 0xd530000 0x00 0x1000>;
	};

	dbg_apmcu_mp0@0d540000 {
		compatible = "mediatek,dbg_apmcu_mp0";
		reg = <0x00 0xd540000 0x00 0x1000>;
	};

	dbg_apmcu_mp0@0d610000 {
		compatible = "mediatek,dbg_apmcu_mp0";
		reg = <0x00 0xd610000 0x00 0x1000>;
	};

	dbg_apmcu_mp0@0d620000 {
		compatible = "mediatek,dbg_apmcu_mp0";
		reg = <0x00 0xd620000 0x00 0x1000>;
	};

	dbg_apmcu_mp0@0d630000 {
		compatible = "mediatek,dbg_apmcu_mp0";
		reg = <0x00 0xd630000 0x00 0x1000>;
	};

	dbg_apmcu_mp0@0d640000 {
		compatible = "mediatek,dbg_apmcu_mp0";
		reg = <0x00 0xd640000 0x00 0x1000>;
	};

	dbg_apmcu_mp0@0d710000 {
		compatible = "mediatek,dbg_apmcu_mp0";
		reg = <0x00 0xd710000 0x00 0x1000>;
	};

	dbg_apmcu_mp0@0d720000 {
		compatible = "mediatek,dbg_apmcu_mp0";
		reg = <0x00 0xd720000 0x00 0x1000>;
	};

	dbg_apmcu_mp0@0d730000 {
		compatible = "mediatek,dbg_apmcu_mp0";
		reg = <0x00 0xd730000 0x00 0x1000>;
	};

	dbg_apmcu_mp0@0d740000 {
		compatible = "mediatek,dbg_apmcu_mp0";
		reg = <0x00 0xd740000 0x00 0x1000>;
	};

	dbg_apmcu_mp1@0d800000 {
		compatible = "mediatek,dbg_apmcu_mp1";
		reg = <0x00 0xd800000 0x00 0x1000>;
	};

	dbg_apmcu_mp1@0d810000 {
		compatible = "mediatek,dbg_apmcu_mp1";
		reg = <0x00 0xd810000 0x00 0x1000>;
	};

	dbg_apmcu_mp1@0d820000 {
		compatible = "mediatek,dbg_apmcu_mp1";
		reg = <0x00 0xd820000 0x00 0x1000>;
	};

	dbg_apmcu_mp1@0d830000 {
		compatible = "mediatek,dbg_apmcu_mp1";
		reg = <0x00 0xd830000 0x00 0x1000>;
	};

	dbg_apmcu_mp1@0d840000 {
		compatible = "mediatek,dbg_apmcu_mp1";
		reg = <0x00 0xd840000 0x00 0x1000>;
	};

	dbg_apmcu_mp1@0d910000 {
		compatible = "mediatek,dbg_apmcu_mp1";
		reg = <0x00 0xd910000 0x00 0x1000>;
	};

	dbg_apmcu_mp1@0d920000 {
		compatible = "mediatek,dbg_apmcu_mp1";
		reg = <0x00 0xd920000 0x00 0x1000>;
	};

	dbg_apmcu_mp1@0d930000 {
		compatible = "mediatek,dbg_apmcu_mp1";
		reg = <0x00 0xd930000 0x00 0x1000>;
	};

	dbg_apmcu_mp1@0d940000 {
		compatible = "mediatek,dbg_apmcu_mp1";
		reg = <0x00 0xd940000 0x00 0x1000>;
	};

	dbg_apmcu_mp1@0da10000 {
		compatible = "mediatek,dbg_apmcu_mp1";
		reg = <0x00 0xda10000 0x00 0x1000>;
	};

	dbg_apmcu_mp1@0da20000 {
		compatible = "mediatek,dbg_apmcu_mp1";
		reg = <0x00 0xda20000 0x00 0x1000>;
	};

	dbg_apmcu_mp1@0da30000 {
		compatible = "mediatek,dbg_apmcu_mp1";
		reg = <0x00 0xda30000 0x00 0x1000>;
	};

	dbg_apmcu_mp1@0da40000 {
		compatible = "mediatek,dbg_apmcu_mp1";
		reg = <0x00 0xda40000 0x00 0x1000>;
	};

	dbg_apmcu_mp1@0db10000 {
		compatible = "mediatek,dbg_apmcu_mp1";
		reg = <0x00 0xdb10000 0x00 0x1000>;
	};

	dbg_apmcu_mp1@0db20000 {
		compatible = "mediatek,dbg_apmcu_mp1";
		reg = <0x00 0xdb20000 0x00 0x1000>;
	};

	dbg_apmcu_mp1@0db30000 {
		compatible = "mediatek,dbg_apmcu_mp1";
		reg = <0x00 0xdb30000 0x00 0x1000>;
	};

	dbg_apmcu_mp1@0db40000 {
		compatible = "mediatek,dbg_apmcu_mp1";
		reg = <0x00 0xdb40000 0x00 0x1000>;
	};

	ap_dma@11000000 {
		compatible = "mediatek,ap_dma";
		reg = <0x00 0x11000000 0x00 0x1000>;
		interrupts = <0x00 0x29 0x08>;
	};

	auxadc@11001000 {
		compatible = "mediatek,auxadc";
		reg = <0x00 0x11001000 0x00 0x1000>;
		interrupts = <0x00 0x14 0x02>;
		clocks = <0x1f 0x21>;
		clock-names = "auxadc-main";
		linux,phandle = <0x95>;
		phandle = <0x95>;
	};

	dma-controller@11000580 {
		compatible = "mediatek,mt6577-uart-dma";
		reg = <0x00 0x11000680 0x00 0x80 0x00 0x11000700 0x00 0x80 0x00 0x11000780 0x00 0x80 0x00 0x11000800 0x00 0x80>;
		interrupts = <0x00 0x35 0x08 0x00 0x36 0x08 0x00 0x37 0x08 0x00 0x3c 0x08>;
		clocks = <0x1f 0x26>;
		clock-names = "apdma";
		#dma-cells = <0x01>;
		linux,phandle = <0x2c>;
		phandle = <0x2c>;
	};

	serial@11020000 {
		compatible = "mediatek,mt6761-uart\0mediatek,mt6577-uart";
		reg = <0x00 0x11002000 0x00 0x1000>;
		interrupts = <0x00 0x23 0x08>;
		clocks = <0x1b 0x1f 0x16>;
		clock-names = "baud\0bus";
		dmas = <0x2c 0x00 0x2c 0x01>;
		dma-names = "tx\0rx";
		linux,phandle = <0x96>;
		phandle = <0x96>;
	};

	serial@11030000 {
		compatible = "mediatek,mt6761-uart\0mediatek,mt6577-uart";
		reg = <0x00 0x11003000 0x00 0x1000>;
		interrupts = <0x00 0x24 0x08>;
		clocks = <0x1b 0x1f 0x17>;
		clock-names = "baud\0bus";
		linux,phandle = <0x97>;
		phandle = <0x97>;
	};

	pwm@11006000 {
		compatible = "mediatek,pwm";
		reg = <0x00 0x11006000 0x00 0x1000>;
		interrupts = <0x00 0x15 0x08>;
		clocks = <0x1f 0x10 0x1f 0x11 0x1f 0x12 0x1f 0x13 0x1f 0x14 0x1f 0x30 0x1f 0x0f 0x1f 0x15>;
		clock-names = "PWM1-main\0PWM2-main\0PWM3-main\0PWM4-main\0PWM5-main\0PWM6-main\0PWM-HCLK-main\0PWM-main";
		linux,phandle = <0x98>;
		phandle = <0x98>;
	};

	i2c_common {
		compatible = "mediatek,i2c_common";
		dma_support = [02];
		idvfs = [01];
		set_dt_div = [01];
		check_max_freq = [01];
		ver = [02];
		set_ltiming = [01];
		ext_time_config = [18 01];
		cnt_constraint = [01];
		linux,phandle = <0x99>;
		phandle = <0x99>;
	};

	i2c0@11007000 {
		compatible = "mediatek,i2c";
		id = <0x00>;
		reg = <0x00 0x11007000 0x00 0x1000 0x00 0x11000080 0x00 0x80>;
		interrupts = <0x00 0x1c 0x08>;
		clocks = <0x1f 0x0b 0x1f 0x26>;
		clock-names = "main\0dma";
		clock-div = <0x05>;
		scl-gpio-id = <0x53>;
		sda-gpio-id = <0x52>;
		gpio_start = <0x10002a00>;
		mem_len = <0x200>;
		eh_cfg = <0x20>;
		pu_cfg = <0x50>;
		rsel_cfg = <0x70>;
		aed = <0x1a>;
		mediatek,hs_only;
		linux,phandle = <0x9a>;
		phandle = <0x9a>;
	};

	i2c1@11008000 {
		compatible = "mediatek,i2c";
		id = <0x01>;
		reg = <0x00 0x11008000 0x00 0x1000 0x00 0x11000100 0x00 0x80>;
		interrupts = <0x00 0x1d 0x08>;
		clocks = <0x1f 0x0b 0x1f 0x26>;
		clock-names = "main\0dma";
		clock-div = <0x05>;
		scl-gpio-id = <0x54>;
		sda-gpio-id = <0x51>;
		gpio_start = <0x10002a00>;
		mem_len = <0x200>;
		eh_cfg = <0x20>;
		pu_cfg = <0x50>;
		rsel_cfg = <0x70>;
		aed = <0x1a>;
		mediatek,hs_only;
		linux,phandle = <0x9b>;
		phandle = <0x9b>;
	};

	i2c2@11009000 {
		compatible = "mediatek,i2c";
		id = <0x02>;
		reg = <0x00 0x11009000 0x00 0x1000 0x00 0x11000180 0x00 0x180>;
		interrupts = <0x00 0x1e 0x08>;
		clocks = <0x1f 0x0b 0x1f 0x26>;
		clock-names = "main\0dma";
		clock-div = <0x05>;
		scl-gpio-id = <0x67>;
		sda-gpio-id = <0x68>;
		gpio_start = <0x10002800>;
		mem_len = <0x200>;
		eh_cfg = <0x20>;
		pu_cfg = <0x60>;
		rsel_cfg = <0xa0>;
		aed = <0x1a>;
		ch_offset_default = <0x100>;
		ch_offset_ccu = <0x200>;
		mediatek,hs_only;
		linux,phandle = <0x9c>;
		phandle = <0x9c>;
	};

	i2c3@1100f000 {
		compatible = "mediatek,i2c";
		id = <0x03>;
		reg = <0x00 0x1100f000 0x00 0x1000 0x00 0x11000300 0x00 0x100>;
		interrupts = <0x00 0x1f 0x08>;
		clocks = <0x1f 0x0b 0x1f 0x26>;
		clock-names = "main\0dma";
		clock-div = <0x05>;
		scl-gpio-id = <0x32>;
		sda-gpio-id = <0x33>;
		gpio_start = <0x10002600>;
		mem_len = <0x200>;
		eh_cfg = <0x20>;
		pu_cfg = <0x90>;
		rsel_cfg = <0xb0>;
		aed = <0x1a>;
		ch_offset_default = <0x100>;
		mediatek,hs_only;
		linux,phandle = <0x9d>;
		phandle = <0x9d>;
	};

	i2c4@11011000 {
		compatible = "mediatek,i2c";
		id = <0x04>;
		reg = <0x00 0x11011000 0x00 0x1000 0x00 0x11000400 0x00 0x180>;
		interrupts = <0x00 0x20 0x08>;
		clocks = <0x1f 0x0b 0x1f 0x26>;
		clock-names = "main\0dma";
		clock-div = <0x05>;
		scl-gpio-id = <0x69>;
		sda-gpio-id = <0x6a>;
		gpio_start = <0x10002800>;
		mem_len = <0x200>;
		eh_cfg = <0x20>;
		pu_cfg = <0x60>;
		rsel_cfg = <0xa0>;
		aed = <0x1a>;
		ch_offset_default = <0x100>;
		ch_offset_ccu = <0x200>;
		mediatek,hs_only;
		linux,phandle = <0x9e>;
		phandle = <0x9e>;
	};

	i2c5@11016000 {
		compatible = "mediatek,i2c";
		id = <0x05>;
		reg = <0x00 0x11016000 0x00 0x1000 0x00 0x11000580 0x00 0x80>;
		interrupts = <0x00 0x4a 0x08>;
		clocks = <0x1f 0x0b 0x1f 0x26>;
		clock-names = "main\0dma";
		clock-div = <0x05>;
		scl-gpio-id = <0x30>;
		sda-gpio-id = <0x31>;
		gpio_start = <0x10002600>;
		mem_len = <0x200>;
		eh_cfg = <0x20>;
		pu_cfg = <0x90>;
		rsel_cfg = <0xb0>;
		aed = <0x1a>;
		mediatek,hs_only;
		linux,phandle = <0x9f>;
		phandle = <0x9f>;
	};

	i2c6@1100d000 {
		compatible = "mediatek,i2c";
		id = <0x06>;
		reg = <0x00 0x1100d000 0x00 0x1000 0x00 0x11000600 0x00 0x80>;
		interrupts = <0x00 0x4b 0x08>;
		clocks = <0x1f 0x0b 0x1f 0x26>;
		clock-names = "main\0dma";
		clock-div = <0x05>;
		scl-gpio-id = <0xa1>;
		sda-gpio-id = <0xa2>;
		gpio_start = <0x10002c00>;
		mem_len = <0x200>;
		eh_cfg = <0x20>;
		pu_cfg = <0x50>;
		rsel_cfg = <0x70>;
		aed = <0x1a>;
		ch_offset_default = <0x100>;
		ch_offset_ccu = <0x200>;
		mediatek,hs_only;
		linux,phandle = <0xa0>;
		phandle = <0xa0>;
	};

	i2c7 {
		linux,phandle = <0xa1>;
		phandle = <0xa1>;
	};

	i2c8 {
		linux,phandle = <0xa2>;
		phandle = <0xa2>;
	};

	i2c9 {
		linux,phandle = <0xa3>;
		phandle = <0xa3>;
	};

	spi0@1100a000 {
		compatible = "mediatek,mt6765-spi";
		mediatek,pad-select = <0x00>;
		reg = <0x00 0x1100a000 0x00 0x1000>;
		interrupts = <0x00 0x3e 0x08>;
		clocks = <0x19 0x0d 0x19 0x74 0x1f 0x1b>;
		clock-names = "parent-clk\0sel-clk\0spi-clk";
		linux,phandle = <0xa4>;
		phandle = <0xa4>;
	};

	therm_ctrl@1100b000 {
		compatible = "mediatek,therm_ctrl";
		reg = <0x00 0x1100b000 0x00 0x1000>;
		interrupts = <0x00 0x16 0x08>;
		clocks = <0x1f 0x0a>;
		clock-names = "therm-main";
	};

	eem_fsm@1100b000 {
		compatible = "mediatek,eem_fsm";
		reg = <0x00 0x1100b000 0x00 0x1000>;
		interrupts = <0x00 0x45 0x08>;
	};

	btif@1100c000 {
		compatible = "mediatek,btif";
		reg = <0x00 0x1100c000 0x00 0x1000 0x00 0x11000880 0x00 0x80 0x00 0x11000900 0x00 0x80>;
		interrupts = <0x00 0x38 0x08 0x00 0x4c 0x08 0x00 0x4d 0x08>;
		clocks = <0x1f 0x1a 0x1f 0x26>;
		clock-names = "btifc\0apdmac";
	};

	consys@18002000 {
		compatible = "mediatek,mt6761-consys";
		#address-cells = <0x02>;
		#size-cells = <0x02>;
		reg = <0x00 0x18002000 0x00 0x1000 0x00 0x10007000 0x00 0x100 0x00 0x10001000 0x00 0x1000 0x00 0x10006000 0x00 0x1000 0x00 0x18007000 0x00 0x1000 0x00 0x180b1000 0x00 0x1000 0x00 0x180a3000 0x00 0x1000 0x00 0x180a5000 0x00 0x800 0x00 0x180c1000 0x00 0x1000 0x00 0x18004000 0x00 0x1000>;
		interrupts = <0x00 0xd3 0x08 0x00 0xd5 0x08 0x00 0xd6 0x01>;
		clocks = <0x20 0x01>;
		clock-names = "conn";
		linux,phandle = <0x0f>;
		phandle = <0x0f>;
	};

	wifi@18000000 {
		compatible = "mediatek,wifi";
		reg = <0x00 0x18000000 0x00 0x100000>;
		interrupts = <0x00 0xd4 0x08>;
	};

	disp_pwm@1100e000 {
		compatible = "mediatek,disp_pwm";
		reg = <0x00 0x1100e000 0x00 0x1000>;
	};

	spi1@11010000 {
		compatible = "mediatek,mt6765-spi";
		mediatek,pad-select = <0x00>;
		reg = <0x00 0x11010000 0x00 0x1000>;
		interrupts = <0x00 0x42 0x08>;
		clocks = <0x19 0x0d 0x19 0x74 0x1f 0x34>;
		clock-names = "parent-clk\0sel-clk\0spi-clk";
		linux,phandle = <0xa5>;
		phandle = <0xa5>;
	};

	spi2@11012000 {
		compatible = "mediatek,mt6765-spi";
		mediatek,pad-select = <0x00>;
		reg = <0x00 0x11012000 0x00 0x1000>;
		interrupts = <0x00 0x48 0x08>;
		clocks = <0x19 0x0d 0x19 0x74 0x1f 0x37>;
		clock-names = "parent-clk\0sel-clk\0spi-clk";
		linux,phandle = <0xa6>;
		phandle = <0xa6>;
	};

	spi3@11013000 {
		compatible = "mediatek,mt6765-spi";
		mediatek,pad-select = <0x00>;
		reg = <0x00 0x11013000 0x00 0x1000>;
		interrupts = <0x00 0x49 0x08>;
		clocks = <0x19 0x0d 0x19 0x74 0x1f 0x38>;
		clock-names = "parent-clk\0sel-clk\0spi-clk";
		linux,phandle = <0xa7>;
		phandle = <0xa7>;
	};

	spi4@11014000 {
		compatible = "mediatek,mt6765-spi";
		mediatek,pad-select = <0x00>;
		reg = <0x00 0x11014000 0x00 0x1000>;
		interrupts = <0x00 0x27 0x08>;
		clocks = <0x19 0x0d 0x19 0x74 0x1f 0x41>;
		clock-names = "parent-clk\0sel-clk\0spi-clk";
		linux,phandle = <0xa8>;
		phandle = <0xa8>;
	};

	spi5@11015000 {
		compatible = "mediatek,mt6765-spi";
		mediatek,pad-select = <0x00>;
		reg = <0x00 0x11015000 0x00 0x1000>;
		interrupts = <0x00 0x28 0x08>;
		clocks = <0x19 0x0d 0x19 0x74 0x1f 0x42>;
		clock-names = "parent-clk\0sel-clk\0spi-clk";
		linux,phandle = <0xa9>;
		phandle = <0xa9>;
	};

	imp_iic@11017000 {
		compatible = "mediatek,imp_iic";
		reg = <0x00 0x11017000 0x00 0x1000>;
	};

	nfi@11018000 {
		compatible = "mediatek,nfi";
		reg = <0x00 0x11018000 0x00 0x1000>;
	};

	nfiecc@11019000 {
		compatible = "mediatek,nfiecc";
		reg = <0x00 0x11019000 0x00 0x1000>;
	};

	usb0@11200000 {
		compatible = "mediatek,mt6761-usb20";
		reg = <0x00 0x11200000 0x00 0x10000 0x00 0x11cc0000 0x00 0x10000>;
		interrupts = <0x00 0x11 0x08>;
		mode = <0x02>;
		multipoint = <0x01>;
		num_eps = <0x10>;
		clocks = <0x1f 0x08 0x19 0x7f 0x19 0x23>;
		clock-names = "usb0\0usb0_clk_top_sel\0usb0_clk_univpll3_d4";
	};

	usb_sif@11210000 {
		compatible = "mediatek,usb_sif";
		reg = <0x00 0x11210000 0x00 0x1000>;
	};

	msdc@11230000 {
		compatible = "mediatek,msdc";
		reg = <0x00 0x11230000 0x00 0x10000>;
		interrupts = <0x00 0x17 0x08>;
		index = [00];
		clk_src = [01];
		bus-width = <0x08>;
		max-frequency = <0xbebc200>;
		cap-mmc-highspeed;
		mmc-ddr-1_8v;
		mmc-hs200-1_8v;
		mmc-hs400-1_8v;
		no-sd;
		no-sdio;
		non-removable;
		pinctl = <0x2d>;
		pinctl_hs400 = <0x2e>;
		pinctl_hs200 = <0x2f>;
		register_setting = <0x30>;
		host_function = [00];
		bootable;
		status = "okay";
		vmmc-supply = <0x31>;
		clocks = <0x1f 0x4f 0x1f 0x1c 0x1f 0x45>;
		clock-names = "msdc0-clock\0msdc0-hclock\0msdc0-aes-clock";
		linux,phandle = <0xaa>;
		phandle = <0xaa>;
	};

	msdc@11240000 {
		compatible = "mediatek,msdc";
		reg = <0x00 0x11240000 0x00 0x10000>;
		interrupts = <0x00 0x18 0x08>;
		index = [01];
		clk_src = [02];
		bus-width = <0x04>;
		max-frequency = <0xbebc200>;
		cap-sd-highspeed;
		sd-uhs-sdr12;
		sd-uhs-sdr25;
		sd-uhs-sdr50;
		sd-uhs-sdr104;
		sd-uhs-ddr50;
		no-mmc;
		no-sdio;
		pinctl = <0x32>;
		pinctl_sdr104 = <0x33>;
		pinctl_sdr50 = <0x34>;
		pinctl_ddr50 = <0x35>;
		register_setting = <0x36>;
		host_function = [01];
		cd_level = [00];
		cd-gpios = <0x37 0x01 0x00>;
		status = "okay";
		vmmc-supply = <0x38>;
		vqmmc-supply = <0x39>;
		clocks = <0x1f 0x50 0x1f 0x1d>;
		clock-names = "msdc1-clock\0msdc1-hclock";
		linux,phandle = <0xab>;
		phandle = <0xab>;
	};

	msdc@11250000 {
		compatible = "mediatek,msdc2";
		reg = <0x00 0x11250000 0x00 0x10000>;
		status = "disable";
		linux,phandle = <0xac>;
		phandle = <0xac>;
	};

	msdc@11260000 {
		compatible = "mediatek,msdc3";
		reg = <0x00 0x11250000 0x00 0x10000>;
		status = "disable";
		linux,phandle = <0xad>;
		phandle = <0xad>;
	};

	msdc1_ins@0 {
		compatible = "mediatek,mt6761-sdcard-ins";
		linux,phandle = <0xae>;
		phandle = <0xae>;
	};

	msdc0_top@11cd0000 {
		compatible = "mediatek,msdc0_top";
		reg = <0x00 0x11cd0000 0x00 0x1000>;
	};

	msdc1_top@11c90000 {
		compatible = "mediatek,msdc1_top";
		reg = <0x00 0x11c90000 0x00 0x1000>;
	};

	usb1p_sif@11210000 {
		compatible = "mediatek,usb1p_sif";
		reg = <0x00 0x11210000 0x00 0x10000>;
	};

	audio@11220000 {
		compatible = "mediatek,audio\0syscon";
		reg = <0x00 0x11220000 0x00 0x1000>;
		#clock-cells = <0x01>;
		mediatek,btcvsd_snd = <0x3a>;
		linux,phandle = <0x3b>;
		phandle = <0x3b>;
	};

	mt_soc_dl1_pcm@11220000 {
		compatible = "mediatek,mt_soc_pcm_dl1";
		reg = <0x00 0x11220000 0x00 0x1000>;
		interrupts = <0x00 0x61 0x08>;
		clocks = <0x3b 0x00 0x3b 0x04 0x3b 0x05 0x3b 0x03 0x3b 0x01 0x3b 0x02 0x3b 0x06 0x1f 0x2b 0x1f 0x33 0x19 0x78 0x19 0x79 0x19 0x05 0x19 0x7a 0x19 0x2b 0x19 0x7b 0x19 0x2e 0x3c 0x06 0x1b>;
		clock-names = "aud_afe_clk\0aud_dac_clk\0aud_dac_predis_clk\0aud_adc_clk\0aud_apll22m_clk\0aud_apll1_tuner_clk\0aud_tml_clk\0aud_infra_clk\0mtkaif_26m_clk\0top_mux_audio\0top_mux_audio_int\0top_sys_pll1_d4\0top_mux_aud_1\0top_apll1_ck\0top_mux_aud_eng1\0top_apll1_d8\0apmixed_apll1\0top_clk26m_clk";
		linux,phandle = <0xaf>;
		phandle = <0xaf>;
	};

	audio_sram@11221000 {
		compatible = "mediatek,audio_sram";
		reg = <0x00 0x11221000 0x00 0x9000>;
	};

	mtk-btcvsd-snd@18050000 {
		compatible = "mediatek,mtk-btcvsd-snd";
		reg = <0x00 0x18050000 0x00 0x1000 0x00 0x18080000 0x00 0x10000>;
		interrupts = <0x00 0xd2 0x08>;
		mediatek,infracfg = <0x1f>;
		mediatek,offset = <0xf00 0x800 0x140 0x144 0x148>;
		linux,phandle = <0x3a>;
		phandle = <0x3a>;
	};

	mipi_rx_ana_csi0a@11c10000 {
		compatible = "mediatek,mipi_rx_ana_csi0a\0syscon";
		reg = <0x00 0x11c10000 0x00 0x1000>;
		#clock-cells = <0x01>;
		linux,phandle = <0x3e>;
		phandle = <0x3e>;
	};

	mipi_rx_ana_csi1@11c20000 {
		compatible = "mediatek,mipi_rx_ana_csi1";
		reg = <0x00 0x11c20000 0x00 0x10000>;
	};

	mipi_rx_ana_csi0b@11c11000 {
		compatible = "mediatek,mipi_rx_ana_csi0b\0syscon";
		reg = <0x00 0x11c11000 0x00 0x1000>;
		#clock-cells = <0x01>;
		linux,phandle = <0x3f>;
		phandle = <0x3f>;
	};

	mipi_rx_ana_csi1a@11c12000 {
		compatible = "mediatek,mipi_rx_ana_csi1a\0syscon";
		reg = <0x00 0x11c12000 0x00 0x1000>;
		#clock-cells = <0x01>;
		linux,phandle = <0x40>;
		phandle = <0x40>;
	};

	mipi_rx_ana_csi1b@11c13000 {
		compatible = "mediatek,mipi_rx_ana_csi1b\0syscon";
		reg = <0x00 0x11c13000 0x00 0x1000>;
		#clock-cells = <0x01>;
		linux,phandle = <0x41>;
		phandle = <0x41>;
	};

	mipi_rx_ana_csi2a@11c14000 {
		compatible = "mediatek,mipi_rx_ana_csi2a\0syscon";
		reg = <0x00 0x11c14000 0x00 0x1000>;
		#clock-cells = <0x01>;
		linux,phandle = <0x42>;
		phandle = <0x42>;
	};

	mipi_rx_ana_csi2b@11c15000 {
		compatible = "mediatek,mipi_rx_ana_csi2b\0syscon";
		reg = <0x00 0x11c15000 0x00 0x1000>;
		#clock-cells = <0x01>;
		linux,phandle = <0x43>;
		phandle = <0x43>;
	};

	mipi_rx_ana_csi2@11c30000 {
		compatible = "mediatek,mipi_rx_ana_csi2";
		reg = <0x00 0x11c30000 0x00 0x10000>;
	};

	efusec@11c50000 {
		compatible = "mediatek,efusec";
		reg = <0x00 0x11c50000 0x00 0x10000>;
	};

	mipi_tx0@11c80000 {
		compatible = "mediatek,mipi_tx0";
		reg = <0x00 0x11c80000 0x00 0x10000>;
	};

	msdc1_pad_macro@11c90000 {
		compatible = "mediatek,msdc1_pad_macro";
		reg = <0x00 0x11c90000 0x00 0x10000>;
	};

	msdc0_pad_macro@11cd0000 {
		compatible = "mediatek,msdc0_pad_macro";
		reg = <0x00 0x11cd0000 0x00 0x10000>;
	};

	mfg_clark@13000000 {
		compatible = "mediatek,clark";
		reg = <0x00 0x13000000 0x00 0x80000>;
		interrupts = <0x00 0xcb 0x08>;
		interrupt-names = "RGX";
		clock-frequency = <0x21f98280>;
	};

	mfg_cfg@13ffe000 {
		compatible = "mediatek,mfgcfg\0syscon";
		reg = <0x00 0x13ffe000 0x00 0x1000>;
		#clock-cells = <0x01>;
		linux,phandle = <0xb0>;
		phandle = <0xb0>;
	};

	gpufreq {
		compatible = "mediatek,mt6761-gpufreq";
		clocks = <0x19 0x6d 0x19 0x28 0x1b 0x20 0x07 0x20 0x04 0x20 0x06>;
		clock-names = "clk_mux\0clk_main_parent\0clk_sub_parent\0mtcmos_mfg_async\0mtcmos_mfg\0mtcmos_mfg_core0";
	};

	mmsys_config@14000000 {
		compatible = "mediatek,mmsys_config\0syscon";
		reg = <0x00 0x14000000 0x00 0x1000>;
		interrupts = <0x00 0xab 0x08>;
		#clock-cells = <0x01>;
		clocks = <0x21 0x17 0x21 0x1a 0x21 0x1b>;
		clock-names = "CAM_MDP\0IMG_DL_RELAY\0IMG_DL_ASYNC_TOP";
		linux,phandle = <0x21>;
		phandle = <0x21>;
	};

	nfc {
		compatible = "mediatek,nfc-gpio-v2";
		gpio-rst = <0xac>;
		gpio-rst-std = <0x37 0xac 0x00>;
		gpio-irq = <0x0a>;
		gpio-irq-std = <0x37 0x0a 0x00>;
		linux,phandle = <0xb1>;
		phandle = <0xb1>;
	};

	irq_nfc {
		compatible = "mediatek,irq_nfc-eint";
		linux,phandle = <0xb2>;
		phandle = <0xb2>;
	};

	disp_mutex0@14001000 {
		compatible = "mediatek,disp_mutex0";
		reg = <0x00 0x14001000 0x00 0x1000>;
		interrupts = <0x00 0x9a 0x08>;
		linux,phandle = <0x2a>;
		phandle = <0x2a>;
	};

	smi_common@14002000 {
		compatible = "mediatek,smi_common";
		reg = <0x00 0x14002000 0x00 0x1000>;
		nr_larbs = <0x03>;
		larbs = <0x1c 0x1d 0x1e>;
		mmsys_config = <0x21>;
		clocks = <0x20 0x03 0x21 0x15 0x21 0x16 0x21 0x13>;
		clock-names = "mtcmos-dis\0smi-comm0\0smi-comm1\0smi-common";
	};

	mmdvfs_pmqos {
		compatible = "mediatek,mmdvfs_pmqos";
		mm_step0 = <0x1b4 0x01 0x00 0x01>;
		mm_step0_ext = <0x1b4 0x02 0x06 0x10c4ec>;
		mm_step1 = <0x138 0x01 0x00 0x02>;
		mm_step1_ext = <0x138 0x02 0x06 0x10c4ec>;
		mm_step2 = <0xe3 0x01 0x00 0x03>;
		mm_step2_ext = <0xe3 0x02 0x06 0x117627>;
		vopp_steps = <0x00 0x01 0x03>;
		disp_freq = "mm_step0\0mm_step1\0mm_step2";
		mdp_freq = "mm_step0\0mm_step1\0mm_step2";
		cam_freq = "mm_step0\0mm_step1\0mm_step2";
		img_freq = "mm_step0\0mm_step1\0mm_step2";
		vdec_freq = "mm_step0\0mm_step1\0mm_step2";
		venc_freq = "mm_step0\0mm_step1\0mm_step2";
		clocks = <0x19 0x6b 0x19 0x24 0x19 0x1a 0x19 0x25>;
		clock-names = "mmdvfs_clk_mm_sel_ck\0mmdvfs_clk_mmpll_ck\0mmdvfs_clk_univpll1_d2_ck\0mmdvfs_clk_mmpll_d2_ck";
	};

	smi_larb0@14003000 {
		cell-index = <0x00>;
		compatible = "mediatek,smi_larb0\0mediatek,smi_larb";
		reg = <0x00 0x14003000 0x00 0x1000>;
		clocks = <0x20 0x03 0x21 0x14>;
		clock-names = "mtcmos-dis\0smi-larb0";
		linux,phandle = <0x1c>;
		phandle = <0x1c>;
	};

	mdp_rdma0@14004000 {
		compatible = "mediatek,mdp_rdma0";
		reg = <0x00 0x14004000 0x00 0x1000>;
		interrupts = <0x00 0x9b 0x08>;
		clocks = <0x21 0x00>;
		clock-names = "MDP_RDMA0";
		linux,phandle = <0x22>;
		phandle = <0x22>;
	};

	mdp_ccorr0@14005000 {
		compatible = "mediatek,mdp_ccorr0";
		reg = <0x00 0x14005000 0x00 0x1000>;
		interrupts = <0x00 0xaa 0x08>;
		clocks = <0x21 0x01>;
		clock-names = "MDP_CCORR";
		linux,phandle = <0x29>;
		phandle = <0x29>;
	};

	mdp_rsz0@14006000 {
		compatible = "mediatek,mdp_rsz0";
		reg = <0x00 0x14006000 0x00 0x1000>;
		interrupts = <0x00 0x9c 0x08>;
		clocks = <0x21 0x02>;
		clock-names = "MDP_RSZ0";
		linux,phandle = <0x23>;
		phandle = <0x23>;
	};

	mdp_rsz1@14007000 {
		compatible = "mediatek,mdp_rsz1";
		reg = <0x00 0x14007000 0x00 0x1000>;
		interrupts = <0x00 0x9d 0x08>;
		clocks = <0x21 0x03>;
		clock-names = "MDP_RSZ1";
		linux,phandle = <0x24>;
		phandle = <0x24>;
	};

	mdp_wdma0@14008000 {
		compatible = "mediatek,mdp_wdma0";
		reg = <0x00 0x14008000 0x00 0x1000>;
		interrupts = <0x00 0xa0 0x08>;
		clocks = <0x21 0x06>;
		clock-names = "MDP_WDMA";
		linux,phandle = <0x25>;
		phandle = <0x25>;
	};

	mdp_wrot0@14009000 {
		compatible = "mediatek,mdp_wrot0";
		reg = <0x00 0x14009000 0x00 0x1000>;
		interrupts = <0x00 0x9f 0x08>;
		clocks = <0x21 0x05>;
		clock-names = "MDP_WROT0";
		linux,phandle = <0x26>;
		phandle = <0x26>;
	};

	mdp_tdshp0@1400a000 {
		compatible = "mediatek,mdp_tdshp0";
		reg = <0x00 0x1400a000 0x00 0x1000>;
		clocks = <0x21 0x04>;
		clock-names = "MDP_TDSHP";
		linux,phandle = <0x27>;
		phandle = <0x27>;
	};

	disp_ovl0@1400b000 {
		compatible = "mediatek,disp_ovl0";
		reg = <0x00 0x1400b000 0x00 0x1000>;
		interrupts = <0x00 0xa1 0x08>;
	};

	disp_ovl0_2l@1400c000 {
		compatible = "mediatek,disp_ovl0_2l";
		reg = <0x00 0x1400c000 0x00 0x1000>;
		interrupts = <0x00 0xad 0x08>;
	};

	disp_rdma0@1400d000 {
		compatible = "mediatek,disp_rdma0";
		reg = <0x00 0x1400d000 0x00 0x1000>;
		interrupts = <0x00 0xa2 0x08>;
	};

	disp_wdma0@1400e000 {
		compatible = "mediatek,disp_wdma0";
		reg = <0x00 0x1400e000 0x00 0x1000>;
		interrupts = <0x00 0xa3 0x08>;
	};

	disp_color0@1400f000 {
		compatible = "mediatek,disp_color0";
		reg = <0x00 0x1400f000 0x00 0x1000>;
		interrupts = <0x00 0xa4 0x08>;
		linux,phandle = <0x28>;
		phandle = <0x28>;
	};

	disp_ccorr0@14010000 {
		compatible = "mediatek,disp_ccorr0";
		reg = <0x00 0x14010000 0x00 0x1000>;
		interrupts = <0x00 0xa5 0x08>;
	};

	disp_aal0@14011000 {
		compatible = "mediatek,disp_aal0";
		reg = <0x00 0x14011000 0x00 0x1000>;
		interrupts = <0x00 0xa6 0x08>;
	};

	disp_gamma0@14012000 {
		compatible = "mediatek,disp_gamma0";
		reg = <0x00 0x14012000 0x00 0x1000>;
		interrupts = <0x00 0xa7 0x08>;
	};

	disp_dither0@14013000 {
		compatible = "mediatek,disp_dither0";
		reg = <0x00 0x14013000 0x00 0x1000>;
		interrupts = <0x00 0xa8 0x08>;
	};

	dsi0@14014000 {
		compatible = "mediatek,dsi0";
		reg = <0x00 0x14014000 0x00 0x1000>;
		interrupts = <0x00 0xa9 0x08>;
	};

	disp_rsz0@14015000 {
		compatible = "mediatek,disp_rsz0";
		reg = <0x00 0x14015000 0x00 0x1000>;
		interrupts = <0x00 0xdc 0x08>;
	};

	mtkfb@0 {
		compatible = "mediatek,mtkfb";
		linux,phandle = <0xb3>;
		phandle = <0xb3>;
	};

	dispsys {
		compatible = "mediatek,dispsys";
		mediatek,larb = <0x1c>;
		clocks = <0x20 0x03 0x21 0x13 0x21 0x14 0x21 0x15 0x21 0x16 0x21 0x07 0x21 0x08 0x21 0x0a 0x21 0x0b 0x21 0x0c 0x21 0x0d 0x21 0x0e 0x21 0x0f 0x21 0x10 0x21 0x11 0x21 0x1c 0x21 0x1d 0x21 0x09 0x3c 0x13 0x19 0x7c 0x1f 0x31 0x1b 0x19 0x1e 0x19 0x2f 0x19 0x31>;
		clock-names = "MMSYS_MTCMOS\0MMSYS_SMI_COMMON\0MMSYS_SMI_LARB0\0MMSYS_GALS_COMM0\0MMSYS_GALS_COMM1\0MMSYS_DISP_OVL0\0MMSYS_DISP_OVL0_2L\0MMSYS_DISP_RDMA0\0MMSYS_DISP_WDMA0\0MMSYS_DISP_COLOR0\0MMSYS_DISP_CCORR0\0MMSYS_DISP_AAL0\0MMSYS_DISP_GAMMA0\0MMSYS_DISP_DITHER0\0MMSYS_DSI0_MM_CK\0MMSYS_DSI0_IF_CK\0MMSYS_26M\0MMSYS_DISP_RSZ0\0APMIXED_MIPI_26M\0TOP_MUX_DISP_PWM\0DISP_PWM\0TOP_26M\0TOP_UNIVPLL2_D4\0TOP_ULPOSC1_D2\0TOP_ULPOSC1_D8";
	};

	dsi_te {
		compatible = "mediatek, DSI_TE-eint";
		status = "disabled";
		linux,phandle = <0xb4>;
		phandle = <0xb4>;
	};

	mm_mutex@14016000 {
		compatible = "mediatek,mm_mutex";
		reg = <0x00 0x14016000 0x00 0x1000>;
		linux,phandle = <0xb5>;
		phandle = <0xb5>;
	};

	camsys@15000000 {
		compatible = "mediatek,camsys\0syscon";
		reg = <0x00 0x15000000 0x00 0x1000>;
		#clock-cells = <0x01>;
		linux,phandle = <0x3d>;
		phandle = <0x3d>;
	};

	ispsys@15000000 {
		compatible = "mediatek,mt6761-ispsys";
		reg = <0x00 0x15004000 0x00 0x9000 0x00 0x1500d000 0x00 0x1000 0x00 0x15000000 0x00 0x52000 0x00 0x15040000 0x00 0x8000 0x00 0x10215000 0x00 0x3000 0x00 0x10211000 0x00 0x1000>;
		interrupts = <0x00 0xb3 0x08 0x00 0xb4 0x08 0x00 0xb5 0x08 0x00 0xb8 0x08 0x00 0xb9 0x08 0x00 0xba 0x08 0x00 0xbb 0x08>;
		clocks = <0x20 0x03 0x20 0x08 0x3d 0x00 0x3d 0x01 0x3d 0x02 0x3d 0x03 0x3d 0x04 0x3d 0x05 0x21 0x15 0x21 0x16 0x21 0x13>;
		clock-names = "CG_SCP_SYS_DIS\0CG_SCP_SYS_CAM\0CG_CAM_LARB2\0CG_CAM\0CG_CAMTG\0CG_CAM_SENINF\0CG_CAMSV0\0CG_CAMSV1\0CG_MM_SMI_COMM0\0CG_MM_SMI_COMM1\0CG_MM_SMI_COMMON";
	};

	smi_larb2@15001000 {
		cell-index = <0x02>;
		compatible = "mediatek,smi_larb2\0mediatek,smi_larb";
		reg = <0x00 0x15001000 0x00 0x1000>;
		clocks = <0x20 0x08 0x21 0x18 0x3d 0x00>;
		clock-names = "mtcmos-cam\0gals-cam2img\0cam-larb2";
		linux,phandle = <0x1e>;
		phandle = <0x1e>;
	};

	cam@15004000 {
		compatible = "mediatek,cam";
		reg = <0x00 0x15004000 0x00 0x1000>;
	};

	cam_lut@15005000 {
		compatible = "mediatek,cam_lut";
		reg = <0x00 0x15005000 0x00 0x1000>;
	};

	camd@15006000 {
		compatible = "mediatek,camd";
		reg = <0x00 0x15006000 0x00 0x1000>;
	};

	cam_dma@15007000 {
		compatible = "mediatek,cam_dma";
		reg = <0x00 0x15007000 0x00 0x1000>;
	};

	fdvt@1500b000 {
		compatible = "mediatek,fdvt";
		reg = <0x00 0x1500b000 0x00 0x1000>;
		interrupts = <0x00 0xb6 0x08>;
		clocks = <0x3d 0x06>;
		clock-names = "FD_CLK_CAM_FDVT";
	};

	cam_inner@1500d000 {
		compatible = "mediatek,cam_inner";
		reg = <0x00 0x1500d000 0x00 0x1000>;
	};

	camd_inner@1500e000 {
		compatible = "mediatek,camd_inner";
		reg = <0x00 0x1500e000 0x00 0x1000>;
	};

	cam_inner_dma@1500f000 {
		compatible = "mediatek,cam_inner_dma";
		reg = <0x00 0x1500f000 0x00 0x1000>;
	};

	camsv0@15050000 {
		compatible = "mediatek,camsv0";
		reg = <0x00 0x15050000 0x00 0x1000>;
	};

	camsv1@15051000 {
		compatible = "mediatek,camsv1";
		reg = <0x00 0x15051000 0x00 0x1000>;
	};

	kd_camera_hw1@15040000 {
		compatible = "mediatek,camera_hw";
		reg = <0x00 0x15040000 0x00 0x1000>;
		clocks = <0x19 0x6f 0x19 0x70 0x19 0x71 0x19 0x72 0x19 0x16 0x19 0x15 0x19 0x20 0x19 0x13 0x19 0x1f 0x19 0x14 0x1b 0x3d 0x03 0x3c 0x0c 0x3c 0x10 0x3e 0x00 0x3f 0x00 0x40 0x00 0x41 0x00 0x42 0x00 0x43 0x00 0x19 0x86 0x19 0x1d 0x20 0x08>;
		clock-names = "CLK_TOP_CAMTG_SEL\0CLK_TOP_CAMTG1_SEL\0CLK_TOP_CAMTG2_SEL\0CLK_TOP_CAMTG3_SEL\0CLK_MCLK_6M\0CLK_MCLK_12M\0CLK_MCLK_13M\0CLK_MCLK_48M\0CLK_MCLK_52M\0CLK_MCLK_24M\0CLK_MCLK_26M\0CLK_CAM_SENINF_CG\0CLK_MIPI_C0_26M_CG\0CLK_MIPI_C1_26M_CG\0CLK_MIPI_ANA_0A_CG\0CLK_MIPI_ANA_0B_CG\0CLK_MIPI_ANA_1A_CG\0CLK_MIPI_ANA_1B_CG\0CLK_MIPI_ANA_2A_CG\0CLK_MIPI_ANA_2B_CG\0CLK_TOP_CAMTM_SEL_CG\0CLK_TOP_CAMTM_208_CG\0CLK_SCP_SYS_CAM";
		pinctrl-names = "default\0cam0_rst0\0cam0_rst1\0cam0_pnd0\0cam0_pnd1\0cam1_rst0\0cam1_rst1\0cam1_pnd0\0cam1_pnd1\0cam2_rst0\0cam2_rst1\0cam2_pnd0\0cam2_pnd1\0cam0_vcamd_on\0cam0_vcamd_off\0cam1_vcamd_on\0cam1_vcamd_off\0cam1_vcama_on\0cam1_vcama_off\0cam2_vcama_on\0cam2_vcama_off\0cam0_mclk_on\0cam0_mclk_off\0cam1_mclk_on\0cam1_mclk_off\0cam2_mclk_on\0cam2_mclk_off\0cam_ldo_vcamaf_1\0cam_ldo_vcamaf_0";
		pinctrl-0 = <0x44>;
		pinctrl-1 = <0x45>;
		pinctrl-2 = <0x46>;
		pinctrl-3 = <0x47>;
		pinctrl-4 = <0x48>;
		pinctrl-5 = <0x49>;
		pinctrl-6 = <0x4a>;
		pinctrl-7 = <0x4b>;
		pinctrl-8 = <0x4c>;
		pinctrl-9 = <0x4d>;
		pinctrl-10 = <0x4e>;
		pinctrl-11 = <0x4f>;
		pinctrl-12 = <0x50>;
		pinctrl-13 = <0x51>;
		pinctrl-14 = <0x52>;
		pinctrl-15 = <0x53>;
		pinctrl-16 = <0x54>;
		pinctrl-17 = <0x55>;
		pinctrl-18 = <0x56>;
		pinctrl-19 = <0x57>;
		pinctrl-20 = <0x58>;
		pinctrl-21 = <0x59>;
		pinctrl-22 = <0x5a>;
		pinctrl-23 = <0x5b>;
		pinctrl-24 = <0x5c>;
		pinctrl-25 = <0x5d>;
		pinctrl-26 = <0x5e>;
		pinctrl-27 = <0x5f>;
		pinctrl-28 = <0x60>;
		cam0_vcama-supply = <0x61>;
		cam2_vcamd-supply = <0x62>;
		cam0_vcamio-supply = <0x63>;
		cam1_vcamio-supply = <0x63>;
		cam2_vcamio-supply = <0x63>;
		status = "okay";
		linux,phandle = <0xb6>;
		phandle = <0xb6>;
	};

	flashlight_core {
		compatible = "mediatek,flashlight_core";
		linux,phandle = <0xb7>;
		phandle = <0xb7>;
	};

	flashlights_mt6370 {
		compatible = "mediatek,flashlights_mt6370";
		decouple = <0x00>;
		linux,phandle = <0xb8>;
		phandle = <0xb8>;

		channel@1 {
			type = <0x00>;
			ct = <0x00>;
			part = <0x00>;
		};

		channel@2 {
			type = <0x00>;
			ct = <0x01>;
			part = <0x00>;
		};
	};

	venc_gcon@17000000 {
		compatible = "mediatek,venc_gcon\0syscon";
		reg = <0x00 0x17000000 0x00 0x10000>;
		clocks = <0x20 0x03 0x20 0x09 0x21 0x15 0x21 0x16 0x21 0x13 0x64 0x03 0x64 0x01>;
		clock-names = "MT_SCP_SYS_DIS\0MT_SCP_SYS_VCODEC\0MT_CG_MM_SMI_COMM0\0MT_CG_MM_SMI_COMM1\0MT_CG_MM_SMI_COMMON\0MT_CG_VDEC\0MT_CG_VENC";
		#clock-cells = <0x01>;
		linux,phandle = <0x64>;
		phandle = <0x64>;
	};

	smi_larb1@17010000 {
		cell-index = <0x01>;
		compatible = "mediatek,smi_larb1\0mediatek,smi_larb";
		reg = <0x00 0x17010000 0x00 0x10000>;
		clocks = <0x20 0x09 0x64 0x01>;
		clock-names = "mtcmos-vcodec\0venc-larb1";
		linux,phandle = <0x1d>;
		phandle = <0x1d>;
	};

	venc@17020000 {
		compatible = "mediatek,venc";
		reg = <0x00 0x17020000 0x00 0x10000>;
		interrupts = <0x00 0xae 0x08>;
	};

	venc_jpg@17030000 {
		compatible = "mediatek,venc_jpg";
		reg = <0x00 0x17030000 0x00 0x10000>;
		interrupts = <0x00 0xb0 0x08>;
		clocks = <0x64 0x02>;
		clock-names = "MT_CG_VENC_JPGENC";
	};

	vdec@17040000 {
		compatible = "mediatek,vdec";
		reg = <0x00 0x17040000 0x00 0x10000>;
		interrupts = <0x00 0xb1 0x08>;
	};

	mbist@17050000 {
		compatible = "mediatek,mbist";
		reg = <0x00 0x17050000 0x00 0x10000>;
	};

	otg_iddig {
		compatible = "mediatek,usb_iddig_bi_eint";
		linux,phandle = <0xb9>;
		phandle = <0xb9>;
	};

	odm {
		compatible = "simple-bus";
		linux,phandle = <0xba>;
		phandle = <0xba>;
	};

	memory-ssmr-features {
		compatible = "mediatek,memory-ssmr-features";
		svp-size = <0x00 0x10000000>;
		iris-recognition-size = <0x00 0x10000000>;
		2d_fr-size = <0x00 0x8000000>;
		tui-size = <0x00 0x4000000>;
		wfd-size = <0x00 0x4000000>;
		prot-sharedmem-size = <0x00 0x8000000>;
		ta-elf-size = <0x00 0x1000000>;
		ta-stack-heap-size = <0x00 0x6000000>;
		sdsp-tee-sharedmem-size = <0x00 0x1000000>;
		sdsp-firmware-size = <0x00 0x1000000>;
		linux,phandle = <0xbb>;
		phandle = <0xbb>;
	};

	audio_snd_card {
		compatible = "mediatek,audio_snd_card";
	};

	mt_soc_deep_buffer_dl_pcm {
		compatible = "mediatek,mt_soc_pcm_deep_buffer_dl";
	};

	mt_soc_ul1_pcm {
		compatible = "mediatek,mt_soc_pcm_capture";
	};

	mt_soc_voice_md1 {
		compatible = "mediatek,mt_soc_pcm_voice_md1";
	};

	mt_soc_uldlloopback_pcm {
		compatible = "mediatek,mt_soc_pcm_uldlloopback";
	};

	mt_soc_i2s0_pcm {
		compatible = "mediatek,mt_soc_pcm_dl1_i2s0";
	};

	mt_soc_mrgrx_pcm {
		compatible = "mediatek,mt_soc_pcm_mrgrx";
	};

	mt_soc_mrgrx_awb_pcm {
		compatible = "mediatek,mt_soc_pcm_mrgrx_awb";
	};

	mt_soc_fm_i2s_pcm {
		compatible = "mediatek,mt_soc_pcm_fm_i2s";
	};

	mt_soc_fm_i2s_awb_pcm {
		compatible = "mediatek,mt_soc_pcm_fm_i2s_awb";
	};

	mt_soc_i2s0dl1_pcm {
		compatible = "mediatek,mt_soc_pcm_dl1_i2s0dl1";
	};

	mt_soc_dl1_awb_pcm {
		compatible = "mediatek,mt_soc_pcm_dl1_awb";
	};

	mt_soc_voice_md1_bt {
		compatible = "mediatek,mt_soc_pcm_voice_md1_bt";
	};

	mt_soc_voip_bt_out {
		compatible = "mediatek,mt_soc_pcm_dl1_bt";
	};

	mt_soc_voip_bt_in {
		compatible = "mediatek,mt_soc_pcm_bt_dai";
	};

	mt_soc_tdmrx_pcm {
		compatible = "mediatek,mt_soc_tdm_capture";
	};

	mt_soc_fm_mrgtx_pcm {
		compatible = "mediatek,mt_soc_pcm_fmtx";
	};

	mt_soc_ul2_pcm {
		compatible = "mediatek,mt_soc_pcm_capture2";
	};

	mt_soc_i2s0_awb_pcm {
		compatible = "mediatek,mt_soc_pcm_i2s0_awb";
	};

	mt_soc_voice_md2 {
		compatible = "mediatek,mt_soc_pcm_voice_md2";
	};

	mt_soc_pcm_dl1_scp_spk {
		compatible = "mediatek,mt_soc_pcm_dl1_scp_spk";
	};

	mt_soc_pcm_voice_scp {
		compatible = "mediatek,mt_soc_pcm_voice_scp";
	};

	mt_soc_routing_pcm {
		compatible = "mediatek,mt_soc_pcm_routing";
	};

	mt_soc_voice_md2_bt {
		compatible = "mediatek,mt_soc_pcm_voice_md2_bt";
	};

	mt_soc_hp_impedance_pcm {
		compatible = "mediatek,mt_soc_pcm_hp_impedance";
	};

	mt_soc_codec_name {
		compatible = "mediatek,mt_soc_codec_63xx";
		use_hp_depop_flow = <0x00>;
		use_ul_260k = <0x00>;
	};

	mt_soc_dummy_pcm {
		compatible = "mediatek,mt_soc_pcm_dummy";
	};

	mt_soc_codec_dummy_name {
		compatible = "mediatek,mt_soc_codec_dummy";
	};

	mt_soc_routing_dai_name {
		compatible = "mediatek,mt_soc_dai_routing";
	};

	mt_soc_dai_name {
		compatible = "mediatek,mt_soc_dai_stub";
	};

	mt_soc_dl2_pcm {
		compatible = "mediatek,mt_soc_pcm_dl2";
	};

	mt_soc_anc_pcm {
		compatible = "mediatek,mt_soc_pcm_anc";
	};

	mt_soc_pcm_voice_ultra {
		compatible = "mediatek,mt_soc_pcm_voice_ultra";
	};

	mt_soc_pcm_voice_usb {
		compatible = "mediatek,mt_soc_pcm_voice_usb";
	};

	mt_soc_pcm_voice_usb_echoref {
		compatible = "mediatek,mt_soc_pcm_voice_usb_echoref";
	};

	mt_charger {
		compatible = "mediatek,mt-charger";
		linux,phandle = <0xbc>;
		phandle = <0xbc>;
	};

	lk_charger {
		compatible = "mediatek,lk_charger";
		enable_anime;
		enable_pe_plus;
		enable_pd20_reset;
		power_path_support;
		max_charger_voltage = <0x632ea0>;
		fast_charge_voltage = <0x2dc6c0>;
		usb_charger_current = <0x7a120>;
		ac_charger_current = <0x1f47d0>;
		ac_charger_input_current = <0x1e8480>;
		non_std_ac_charger_current = <0x1e8480>;
		charging_host_charger_current = <0x16e360>;
		ta_ac_charger_current = <0x2dc6c0>;
		pd_charger_current = <0x7a120>;
		temp_t4_threshold = <0x32>;
		temp_t3_threshold = <0x2d>;
		temp_t1_threshold = <0x00>;
		linux,phandle = <0xbd>;
		phandle = <0xbd>;
	};

	charger {
		compatible = "mediatek,charger";
		algorithm_name = "SwitchCharging";
		enable_pe_plus;
		enable_pe_2;
		enable_pe_3;
		enable_pe_4;
		enable_type_c;
		power_path_support;
		enable_dynamic_mivr;
		disable_pd_dual;
		battery_cv = <0x426030>;
		max_charger_voltage = <0x632ea0>;
		min_charger_voltage = <0x4630c0>;
		min_charger_voltage_1 = <0x432380>;
		min_charger_voltage_2 = <0x401640>;
		max_dmivr_charger_current = <0x155cc0>;
		usb_charger_current_suspend = <0x00>;
		usb_charger_current_unconfigured = <0x11170>;
		usb_charger_current_configured = <0x7a120>;
		usb_charger_current = <0x7a120>;
		ac_charger_current = <0x1f47d0>;
		ac_charger_input_current = <0x1e8480>;
		non_std_ac_charger_current = <0x1e8480>;
		charging_host_charger_current = <0x16e360>;
		apple_1_0a_charger_current = <0x9eb10>;
		apple_2_1a_charger_current = "\0\f5";
		ta_ac_charger_current = <0x2dc6c0>;
		jeita_temp_above_t4_cv = <0x40b280>;
		jeita_temp_t3_to_t4_cv = <0x40b280>;
		jeita_temp_t2_to_t3_cv = <0x423920>;
		jeita_temp_t1_to_t2_cv = <0x40b280>;
		jeita_temp_t0_to_t1_cv = <0x3da540>;
		jeita_temp_below_t0_cv = <0x3da540>;
		temp_t4_thres = <0x32>;
		temp_t4_thres_minus_x_degree = <0x2f>;
		temp_t3_thres = <0x2d>;
		temp_t3_thres_minus_x_degree = <0x27>;
		temp_t2_thres = <0x0a>;
		temp_t2_thres_plus_x_degree = <0x10>;
		temp_t1_thres = <0x00>;
		temp_t1_thres_plus_x_degree = <0x06>;
		temp_t0_thres = <0x00>;
		temp_t0_thres_plus_x_degree = <0x00>;
		temp_neg_10_thres = <0x00>;
		enable_min_charge_temp;
		min_charge_temp = <0x00>;
		min_charge_temp_plus_x_degree = <0x06>;
		max_charge_temp = <0x37>;
		max_charge_temp_minus_x_degree = <0x2f>;
		ta_9v_support;
		pe_ichg_level_threshold = <0xf4240>;
		ta_ac_12v_input_current = <0x16e360>;
		ta_ac_9v_input_current = <0x1e8480>;
		ta_ac_7v_input_current = <0x1e8480>;
		pe20_ichg_level_threshold = <0xf4240>;
		ta_start_battery_soc = <0x00>;
		ta_stop_battery_soc = <0x55>;
		high_temp_to_leave_pe40 = <0x2e>;
		high_temp_to_enter_pe40 = <0x27>;
		low_temp_to_leave_pe40 = <0x0a>;
		low_temp_to_enter_pe40 = <0x10>;
		pe40_single_charger_input_current = <0x2dc6c0>;
		pe40_single_charger_current = <0x2dc6c0>;
		pe40_dual_charger_input_current = <0x2dc6c0>;
		pe40_dual_charger_chg1_current = <0x1e8480>;
		pe40_dual_charger_chg2_current = <0x1e8480>;
		pe40_stop_battery_soc = <0x50>;
		pe40_r_cable_1a_lower = <0x229>;
		pe40_r_cable_2a_lower = <0x19f>;
		pe40_r_cable_3a_lower = <0x113>;
		chg1_ta_ac_charger_current = <0x16e360>;
		chg2_ta_ac_charger_current = <0x16e360>;
		slave_mivr_diff = <0x186a0>;
		dual_polling_ieoc = <0x6ddd0>;
		cable_imp_threshold = <0x2bb>;
		vbat_cable_imp_threshold = <0x3b8260>;
		bif_threshold1 = <0x40d990>;
		bif_threshold2 = <0x419ce0>;
		bif_cv_under_threshold2 = <0x43e6d0>;
		pd_vbus_low_bound = <0x4c4b40>;
		pd_vbus_upper_bound = <0x4c4b40>;
		pd_ichg_level_threshold = <0xf4240>;
		pd_stop_battery_soc = <0x50>;
		ibus_err = <0x0e>;
		vsys_watt = <0x4c4b40>;
		linux,phandle = <0xbe>;
		phandle = <0xbe>;
	};

	pd_adapter {
		compatible = "mediatek,pd_adapter";
		adapter_name = "pd_adapter";
		linux,phandle = <0xbf>;
		phandle = <0xbf>;
	};

	rt9465_slave_chr {
		compatible = "richtek,rt9465";
		status = "disabled";
		linux,phandle = <0xc0>;
		phandle = <0xc0>;
	};

	rt-pd-manager {
		compatible = "mediatek,rt-pd-manager";
	};

	mt6370_pmu_eint {
		linux,phandle = <0xc1>;
		phandle = <0xc1>;
	};

	pmic_clock_buffer_ctrl {
		compatible = "mediatek,pmic_clock_buffer";
		mediatek,clkbuf-quantity = <0x07>;
		mediatek,clkbuf-config = <0x02 0x01 0x01 0x02 0x00 0x00 0x00>;
		mediatek,clkbuf-driving-current = <0x01 0x01 0x01 0x01 0x01 0x01 0x01>;
		linux,phandle = <0xc2>;
		phandle = <0xc2>;
	};

	pseudo_m4u {
		compatible = "mediatek,mt-pseudo_m4u";
		iommus = <0x65 0x02>;
	};

	pseudo_m4u-larb0 {
		compatible = "mediatek,mt-pseudo_m4u-port";
		mediatek,larbid = <0x00>;
		iommus = <0x65 0x00 0x65 0x01 0x65 0x02 0x65 0x03 0x65 0x04 0x65 0x05 0x65 0x06 0x65 0x07>;
	};

	pseudo_m4u-larb1 {
		compatible = "mediatek,mt-pseudo_m4u-port";
		mediatek,larbid = <0x01>;
		iommus = <0x65 0x20 0x65 0x21>;
	};

	pseudo_m4u-larb2 {
		compatible = "mediatek,mt-pseudo_m4u-port";
		mediatek,larbid = <0x02>;
		iommus = <0x65 0x40 0x65 0x41>;
	};

	radio_md_cfg {
		compatible = "mediatek,radio_md_cfg";
		linux,phandle = <0xc3>;
		phandle = <0xc3>;
	};

	dynamic_options {
		compatible = "mediatek,dynamic_options";
		linux,phandle = <0xc4>;
		phandle = <0xc4>;
	};

	mt6370_pmu_dts {
		interrupt-controller;
		#interrupt-cells = <0x01>;
		mt6370,intr_gpio_num = <0x03>;
		mt6370,intr_gpio = <0x37 0x03 0x00>;
		linux,phandle = <0xc5>;
		phandle = <0xc5>;

		core {
			compatible = "mediatek,mt6370_pmu_core";
			interrupt-names = "otp\0vdda_ovp\0vdda_uv";
			i2cstmr_rst_tmr = <0x00>;
			mrstb_en;
			mrstb_tmr = <0x03>;
			int_wdt = <0x00>;
			int_deg = <0x00>;
		};

		charger {
			compatible = "mediatek,mt6370_pmu_charger";
			interrupt-names = "chg_mivr\0chg_aiclmeasi\0attachi\0ovpctrl_uvp_d_evt\0chg_wdtmri\0chg_vbusov\0chg_tmri\0chg_treg\0dcdti";
			charger_name = "primary_chg";
			load_switch_name = "primary_load_switch";
			ichg = <0x1e8480>;
			aicr = <0x7a120>;
			mivr = <0x432380>;
			cv = <0x426030>;
			ieoc = <0x249f0>;
			safety_timer = <0x0c>;
			dc_wdt = "\0=\t";
			ircmp_resistor = <0x61a8>;
			ircmp_vclamp = <0x7d00>;
			enable_te;
			enable_wdt;
			lbp_hys_sel = <0x01>;
			lbp_dt = <0x01>;
		};

		mt6370_pmu_fled1 {
			compatible = "mediatek,mt6370_pmu_fled1";
			interrupt-names = "fled_lvf\0fled2_short\0fled1_short";
			fled_enable = <0x01>;
			torch_cur = <0x493e0>;
			strobe_cur = <0x124f80>;
			strobe_timeout = <0x960>;
		};

		mt6370_pmu_fled2 {
			compatible = "mediatek,mt6370_pmu_fled2";
			fled_enable = <0x01>;
			torch_cur = <0x30d40>;
			strobe_cur = <0xf4240>;
			strobe_timeout = <0x4b0>;
		};

		ldo {
			compatible = "mediatek,mt6370_pmu_ldo";
			interrupt-names = "ldo_oc";
			ldo_oms = <0x01>;
			ldo_vrc_lt = <0x01>;

			mt6370_ldo {
				regulator-name = "irtx_ldo";
				regulator-min-microvolt = <0x186a00>;
				regulator-max-microvolt = "\0=\t";
			};
		};

		rgbled {
			compatible = "mediatek,mt6370_pmu_rgbled";
			interrupt-names = "isink4_short\0isink3_short\0isink2_short\0isink1_short\0isink4_open\0isink3_open\0isink2_open\0isink1_open";
			mt,led_name = "green\0red\0blue\0mt6370_pmu_led4";
			mt,led_default_trigger = "cc_mode\0cc_mode\0cc_mode\0none";
		};

		bled {
			compatible = "mediatek,mt6370_pmu_bled";
			interrupt-names = "bled_ocp";
			mt,bled_name = "mt6370_pmu_bled";
			mt,chan_en = <0x0f>;
			mt,map_linear;
			mt,bl_ovp_level = <0x03>;
			mt,bl_ocp_level = <0x02>;
			mt,use_pwm;
			mt,pwm_fsample = <0x02>;
			mt,pwm_deglitch = <0x01>;
			mt,pwm_hys_en = <0x01>;
			mt,pwm_hys = <0x00>;
			mt,pwm_avg_cycle = <0x00>;
			mt,bled_ramptime = <0x03>;
			mt,bled_flash_ramp = <0x01>;
			mt,max_bled_brightness = <0x200>;
			mt,bled_curr_scale = <0x00>;
			mt,pwm_lpf_coef = <0x00>;
		};

		dsv {
			compatible = "mediatek,mt6370_pmu_dsv";
			interrupt-names = "dsv_vneg_ocp\0dsv_vpos_ocp\0dsv_bst_ocp\0dsv_vneg_scp\0dsv_vpos_scp";
			db_ext_en = <0x00>;
			db_periodic_fix = <0x00>;
			db_single_pin = <0x00>;
			db_freq_pm = <0x00>;
			db_periodic_mode = <0x00>;
			db_startup = <0x00>;
			db_vneg_20ms = <0x01>;
			db_vneg_disc = <0x00>;
			db_vpos_20ms = <0x01>;
			db_vpos_disc = <0x01>;
			db_delay = <0x03>;
			db_vbst = <0x1644>;
			db_vpos_slew = <0x01>;
			db_vneg_slew = <0x01>;

			mt6370_dsvp {
				regulator-name = "dsv_pos";
				regulator-min-microvolt = "\0=\t";
				regulator-max-microvolt = <0x5b8d80>;
			};

			mt6370_dsvn {
				regulator-name = "dsv_neg";
				regulator-min-microvolt = "\0=\t";
				regulator-max-microvolt = <0x5b8d80>;
			};
		};
	};

	type_c_port0 {
		tcpc-dual,supported_modes = <0x00>;
		mt-tcpc,name = "type_c_port0";
		mt-tcpc,role_def = <0x04>;
		mt-tcpc,rp_level = <0x00>;
		mt-tcpc,vconn_supply = <0x01>;
		mt6370pd,intr_gpio = <0x37 0x18 0x00>;
		mt6370pd,intr_gpio_num = <0x18>;
		linux,phandle = <0xc6>;
		phandle = <0xc6>;

		pd-data {
			pd,vid = <0x29cf>;
			pd,pid = <0x5081>;
			pd,source-cap-ext = <0x171129cf 0x00 0x102 0x00 0x00 0x2000000>;
			pd,mfrs = "RichtekTCPC";
			pd,charging_policy = <0x21>;
			pd,source-pdo-size = <0x01>;
			pd,source-pdo-data = <0x19032>;
			pd,sink-pdo-size = <0x02>;
			pd,sink-pdo-data = <0x190c8 0xc0761e3c>;
			pd,id-vdo-size = <0x03>;
			pd,id-vdo-data = <0xd10029cf 0x00 0x10000>;
			bat,nr = <0x01>;
			pd,country_nr = <0x00>;

			bat-info0 {
				bat,vid = <0x29cf>;
				bat,pid = <0x1711>;
				bat,mfrs = "bat1";
				bat,design_cap = <0xbb8>;
			};
		};

		dpm_caps {
			local_dr_power;
			local_dr_data;
			local_usb_comm;
			local_no_suspend;
			local_vconn_supply;
			attemp_enter_dp_mode;
			attemp_discover_cable;
			attemp_discover_id;
			pr_check = <0x00>;
			pr_check_gp_source;
			dr_check = <0x00>;
		};
	};

	__symbols__ {
		chosen = "/chosen";
		cpu0 = "/cpus/cpu@000";
		cpu1 = "/cpus/cpu@001";
		cpu2 = "/cpus/cpu@002";
		cpu3 = "/cpus/cpu@003";
		STANDBY = "/cpus/idle-states/standby";
		MCDI_CPU = "/cpus/idle-states/mcdi-cpu";
		MCDI_CLUSTER = "/cpus/idle-states/mcdi-cluster";
		SODI = "/cpus/idle-states/sodi";
		SODI3 = "/cpus/idle-states/sodi3";
		DPIDLE = "/cpus/idle-states/dpidle";
		SUSPEND = "/cpus/idle-states/suspend";
		reserved_memory = "/reserved-memory";
		cpu_dbgapb = "/cpu_dbgapb@0d410000";
		gic = "/interrupt-controller@0c000000";
		sysirq = "/intpol-controller@10200a80";
		infracfg_ao = "/infracfg_ao@10001000";
		scpsys = "/scpsys@10001000";
		topckgen = "/topckgen@10000000";
		syscfg_pctl_1 = "/syscfg_pctl_1@10002000";
		syscfg_pctl_2 = "/syscfg_pctl_2@10002200";
		syscfg_pctl_3 = "/syscfg_pctl_3@10002400";
		syscfg_pctl_4 = "/syscfg_pctl_4@10002600";
		syscfg_pctl_5 = "/syscfg_pctl_5@10002800";
		syscfg_pctl_6 = "/syscfg_pctl_6@10002a00";
		syscfg_pctl_7 = "/syscfg_pctl_7@10002c00";
		pericfg = "/pericfg@10003000";
		smart_pa = "/smart_pa";
		tcpc_pd = "/tcpc_pd";
		md1_sim1_hot_plug_eint = "/md1_sim1_hot_plug_eint";
		md1_sim2_hot_plug_eint = "/md1_sim2_hot_plug_eint";
		gpio_usage_mapping = "/gpio";
		gpio = "/gpio@10005000";
		syscfg_pctl_0 = "/syscfg_pctl_0@10005000";
		pio = "/pinctrl@1000b000";
		msdc0_pins_default = "/pinctrl@1000b000/msdc0@default";
		msdc0_pins_hs400 = "/pinctrl@1000b000/msdc0@hs400";
		msdc0_pins_hs200 = "/pinctrl@1000b000/msdc0@hs200";
		msdc0_register_setting_default = "/pinctrl@1000b000/msdc0@register_default";
		msdc1_pins_default = "/pinctrl@1000b000/msdc1@default";
		msdc1_pins_sdr104 = "/pinctrl@1000b000/msdc1@sdr104";
		msdc1_pins_sdr50 = "/pinctrl@1000b000/msdc1@sdr50";
		msdc1_pins_ddr50 = "/pinctrl@1000b000/msdc1@ddr50";
		msdc1_register_setting_default = "/pinctrl@1000b000/msdc1@register_default";
		msdc3_pins_default = "/pinctrl@1000b000/msdc3@default";
		msdc3_register_setting_default = "/pinctrl@1000b000/msdc3@register_default";
		camera_pins_cam0_mclk_on = "/pinctrl@1000b000/camera_pins_cam0_mclk_on";
		camera_pins_cam0_mclk_off = "/pinctrl@1000b000/camera_pins_cam0_mclk_off";
		camera_pins_cam1_mclk_on = "/pinctrl@1000b000/camera_pins_cam1_mclk_on";
		camera_pins_cam1_mclk_off = "/pinctrl@1000b000/camera_pins_cam1_mclk_off";
		camera_pins_cam2_mclk_on = "/pinctrl@1000b000/camera_pins_cam2_mclk_on";
		camera_pins_cam2_mclk_off = "/pinctrl@1000b000/camera_pins_cam2_mclk_off";
		camera_pins_cam0_rst0 = "/pinctrl@1000b000/cam0@0";
		camera_pins_cam0_rst1 = "/pinctrl@1000b000/cam0@1";
		camera_pins_cam0_pnd0 = "/pinctrl@1000b000/cam0@2";
		camera_pins_cam0_pnd1 = "/pinctrl@1000b000/cam0@3";
		camera_pins_cam1_rst0 = "/pinctrl@1000b000/cam1@0";
		camera_pins_cam1_rst1 = "/pinctrl@1000b000/cam1@1";
		camera_pins_cam1_pnd0 = "/pinctrl@1000b000/cam1@2";
		camera_pins_cam1_pnd1 = "/pinctrl@1000b000/cam1@3";
		camera_pins_cam2_rst0 = "/pinctrl@1000b000/cam2@0";
		camera_pins_cam2_rst1 = "/pinctrl@1000b000/cam2@1";
		camera_pins_cam2_pnd0 = "/pinctrl@1000b000/cam2@2";
		camera_pins_cam2_pnd1 = "/pinctrl@1000b000/cam2@3";
		camera_pins_cam_ldo_rear_vcamd_0 = "/pinctrl@1000b000/cam0@vcamd0";
		camera_pins_cam_ldo_rear_vcamd_1 = "/pinctrl@1000b000/cam0@vcamd1";
		camera_pins_cam_ldo_sub_vcamd_0 = "/pinctrl@1000b000/cam1@vcamd0";
		camera_pins_cam_ldo_sub_vcamd_1 = "/pinctrl@1000b000/cam1@vcamd1";
		camera_pins_cam_ldo_sub_vcama_0 = "/pinctrl@1000b000/cam1@vcama0";
		camera_pins_cam_ldo_sub_vcama_1 = "/pinctrl@1000b000/cam1@vcama1";
		camera_pins_cam_ldo_rear2_vcama_0 = "/pinctrl@1000b000/cam2@vcama0";
		camera_pins_cam_ldo_rear2_vcama_1 = "/pinctrl@1000b000/cam2@vcama1";
		camera_pins_cam0_vcamaf_on = "/pinctrl@1000b000/camera_pins_cam0_vcamaf_on";
		camera_pins_cam0_vcamaf_off = "/pinctrl@1000b000/camera_pins_cam0_vcamaf_off";
		camera_pins_default = "/pinctrl@1000b000/camdefault";
		clk26m = "/clocks/clk26m";
		clk32k = "/clocks/clk32k";
		timer = "/timer@10008000";
		apmixed = "/apmixed@1000c000";
		main_pmic = "/mt-pmic";
		pmic_auxadc = "/mt-pmic/mt635x-auxadc";
		mt_pmic_vs1_buck_reg = "/mt-pmic/buck_regulators/buck_vs1";
		mt_pmic_vmodem_buck_reg = "/mt-pmic/buck_regulators/buck_vmodem";
		mt_pmic_vcore_buck_reg = "/mt-pmic/buck_regulators/buck_vcore";
		mt_pmic_vproc_buck_reg = "/mt-pmic/buck_regulators/buck_vproc";
		mt_pmic_vpa_buck_reg = "/mt-pmic/buck_regulators/buck_vpa";
		mt_pmic_vfe28_ldo_reg = "/mt-pmic/ldo_regulators/ldo_vfe28";
		mt_pmic_vxo22_ldo_reg = "/mt-pmic/ldo_regulators/ldo_vxo22";
		mt_pmic_vrf18_ldo_reg = "/mt-pmic/ldo_regulators/ldo_vrf18";
		mt_pmic_vrf12_ldo_reg = "/mt-pmic/ldo_regulators/ldo_vrf12";
		mt_pmic_vefuse_ldo_reg = "/mt-pmic/ldo_regulators/ldo_vefuse";
		mt_pmic_vcn33_bt_ldo_reg = "/mt-pmic/ldo_regulators/ldo_vcn33_bt";
		mt_pmic_vcn33_wifi_ldo_reg = "/mt-pmic/ldo_regulators/ldo_vcn33_wifi";
		mt_pmic_vcn28_ldo_reg = "/mt-pmic/ldo_regulators/ldo_vcn28";
		mt_pmic_vcn18_ldo_reg = "/mt-pmic/ldo_regulators/ldo_vcn18";
		mt_pmic_vcama_ldo_reg = "/mt-pmic/ldo_regulators/ldo_vcama";
		mt_pmic_vcamd_ldo_reg = "/mt-pmic/ldo_regulators/ldo_vcamd";
		mt_pmic_vcamio_ldo_reg = "/mt-pmic/ldo_regulators/ldo_vcamio";
		mt_pmic_vldo28_ldo_reg = "/mt-pmic/ldo_regulators/ldo_vldo28";
		mt_pmic_vsram_others_ldo_reg = "/mt-pmic/ldo_regulators/ldo_vsram_others";
		mt_pmic_vsram_proc_ldo_reg = "/mt-pmic/ldo_regulators/ldo_vsram_proc";
		mt_pmic_vaux18_ldo_reg = "/mt-pmic/ldo_regulators/ldo_vaux18";
		mt_pmic_vaud28_ldo_reg = "/mt-pmic/ldo_regulators/ldo_vaud28";
		mt_pmic_vio28_ldo_reg = "/mt-pmic/ldo_regulators/ldo_vio28";
		mt_pmic_vio18_ldo_reg = "/mt-pmic/ldo_regulators/ldo_vio18";
		mt_pmic_vdram_ldo_reg = "/mt-pmic/ldo_regulators/ldo_vdram";
		mt_pmic_vmc_ldo_reg = "/mt-pmic/ldo_regulators/ldo_vmc";
		mt_pmic_vmch_ldo_reg = "/mt-pmic/ldo_regulators/ldo_vmch";
		mt_pmic_vemc_ldo_reg = "/mt-pmic/ldo_regulators/ldo_vemc";
		mt_pmic_vsim1_ldo_reg = "/mt-pmic/ldo_regulators/ldo_vsim1";
		mt_pmic_vsim2_ldo_reg = "/mt-pmic/ldo_regulators/ldo_vsim2";
		mt_pmic_vibr_ldo_reg = "/mt-pmic/ldo_regulators/ldo_vibr";
		mt_pmic_vusb33_ldo_reg = "/mt-pmic/ldo_regulators/ldo_vusb33";
		keypad = "/kp@10010000";
		mrdump_ext_rst = "/mrdump_ext_rst";
		touch = "/touch";
		accdet = "/accdet";
		goodix_fp = "/fingerprint";
		bat_gm30 = "/battery";
		iommu = "/m4u@10205000";
		mdcldma = "/mdcldma@10014000";
		gce = "/gce@10238000";
		gce_mbox = "/gce_mbox@10238000";
		auxadc = "/auxadc@11001000";
		apdma = "/dma-controller@11000580";
		uart0 = "/serial@11020000";
		uart1 = "/serial@11030000";
		pwm = "/pwm@11006000";
		i2c_common = "/i2c_common";
		i2c0 = "/i2c0@11007000";
		i2c1 = "/i2c1@11008000";
		i2c2 = "/i2c2@11009000";
		i2c3 = "/i2c3@1100f000";
		i2c4 = "/i2c4@11011000";
		i2c5 = "/i2c5@11016000";
		i2c6 = "/i2c6@1100d000";
		i2c7 = "/i2c7";
		i2c8 = "/i2c8";
		i2c9 = "/i2c9";
		spi0 = "/spi0@1100a000";
		consys = "/consys@18002000";
		spi1 = "/spi1@11010000";
		spi2 = "/spi2@11012000";
		spi3 = "/spi3@11013000";
		spi4 = "/spi4@11014000";
		spi5 = "/spi5@11015000";
		msdc0 = "/msdc@11230000";
		msdc1 = "/msdc@11240000";
		msdc2 = "/msdc@11250000";
		msdc3 = "/msdc@11260000";
		msdc1_ins = "/msdc1_ins@0";
		audio = "/audio@11220000";
		audgpio = "/mt_soc_dl1_pcm@11220000";
		btcvsd_snd = "/mtk-btcvsd-snd@18050000";
		mipi_rx_ana_csi0a = "/mipi_rx_ana_csi0a@11c10000";
		mipi_rx_ana_csi0b = "/mipi_rx_ana_csi0b@11c11000";
		mipi_rx_ana_csi1a = "/mipi_rx_ana_csi1a@11c12000";
		mipi_rx_ana_csi1b = "/mipi_rx_ana_csi1b@11c13000";
		mipi_rx_ana_csi2a = "/mipi_rx_ana_csi2a@11c14000";
		mipi_rx_ana_csi2b = "/mipi_rx_ana_csi2b@11c15000";
		mfg_cfg = "/mfg_cfg@13ffe000";
		mmsys_config = "/mmsys_config@14000000";
		nfc = "/nfc";
		irq_nfc = "/irq_nfc";
		disp_mutex0 = "/disp_mutex0@14001000";
		smi_larb0 = "/smi_larb0@14003000";
		mdp_rdma0 = "/mdp_rdma0@14004000";
		mdp_ccorr = "/mdp_ccorr0@14005000";
		mdp_rsz0 = "/mdp_rsz0@14006000";
		mdp_rsz1 = "/mdp_rsz1@14007000";
		mdp_wdma0 = "/mdp_wdma0@14008000";
		mdp_wrot0 = "/mdp_wrot0@14009000";
		mdp_tdshp0 = "/mdp_tdshp0@1400a000";
		disp_color0 = "/disp_color0@1400f000";
		mtkfb = "/mtkfb@0";
		dsi_te = "/dsi_te";
		mm_mutex = "/mm_mutex@14016000";
		camsys = "/camsys@15000000";
		smi_larb2 = "/smi_larb2@15001000";
		kd_camera_hw1 = "/kd_camera_hw1@15040000";
		flashlight_core = "/flashlight_core";
		flashlights_mt6370 = "/flashlights_mt6370";
		venc_gcon = "/venc_gcon@17000000";
		smi_larb1 = "/smi_larb1@17010000";
		otg_iddig = "/otg_iddig";
		odm = "/odm";
		memory_ssmr_features = "/memory-ssmr-features";
		mt_charger = "/mt_charger";
		lk_charger = "/lk_charger";
		charger = "/charger";
		pd_adapter = "/pd_adapter";
		rt9465_slave_chr = "/rt9465_slave_chr";
		subpmic_pmu_eint = "/mt6370_pmu_eint";
		pmic_clock_buffer_ctrl = "/pmic_clock_buffer_ctrl";
		radio_md_cfg = "/radio_md_cfg";
		dynamic_options = "/dynamic_options";
		mt6370_pmu = "/mt6370_pmu_dts";
		mt6370_typec = "/type_c_port0";
	};
};
